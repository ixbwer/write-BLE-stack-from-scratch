## CMakeLists.txt
```
# SPDX-License-Identifier: Apache-2.0

cmake_minimum_required(VERSION 3.20.0)
find_package(Zephyr REQUIRED HINTS $ENV{ZEPHYR_BASE})
project(ble_phy_tifs_sw)

target_sources(app PRIVATE
  src/main.c
  src/hal_radio.c
  src/ll_pdu.c
  src/adv.c
)

# Add BLE controller internal include paths so we can use HAL APIs and PDU structs
target_include_directories(app PRIVATE
  # controller root — resolves "hal/radio.h" -> controller/hal/radio.h (redirect)
  ${ZEPHYR_BASE}/subsys/bluetooth/controller
  # controller/include — resolves "ll.h" etc.
  ${ZEPHYR_BASE}/subsys/bluetooth/controller/include
  # Nordic vendor — resolves "hal/radio_vendor_hal.h" -> "hal/nrf5/radio/radio.h"
  ${ZEPHYR_BASE}/subsys/bluetooth/controller/ll_sw/nordic
  # ll_sw — resolves "pdu.h", "pdu_df.h"
  ${ZEPHYR_BASE}/subsys/bluetooth/controller/ll_sw
  # Nordic LLL — resolves "pdu_vendor.h"
  ${ZEPHYR_BASE}/subsys/bluetooth/controller/ll_sw/nordic/lll
)
```

## prj.conf
```kconfig
# BLE PHY SW TIFS Demo
# 使用 TIMER1 + PPI 实现软件 TIFS 切换

CONFIG_GPIO=y
CONFIG_SERIAL=y
CONFIG_CONSOLE=y
CONFIG_UART_CONSOLE=y
CONFIG_PRINTK=y

# 启用 BLE Controller (Split Link Layer) — 编译 HAL 代码
CONFIG_BT=y
CONFIG_BT_LL_SW_SPLIT=y
CONFIG_BT_BROADCASTER=y

# 不需要 Host 层功能
CONFIG_BT_OBSERVER=n
CONFIG_BT_PERIPHERAL=n
CONFIG_BT_CENTRAL=n
```

## src/main.c
```c
/*
 * BLE PHY 软件 TIFS (SW TIFS) Demo — 全局变量定义与主入口
 *
 * 基于 phy_adv_scan, 本 Demo 的关键改进:
 *
 *   使用 NRF_TIMER1 + PPI 硬件互联替代 NRF_RADIO->TIFS 寄存器,
 *   实现与真实 Controller 中 !CONFIG_BT_CTLR_TIFS_HW 路径相同的
 *   软件 TIFS 机制。
 *
 * 代码结构:
 *   ble_common.h  — 公共类型、常量与全局变量声明
 *   hal_radio.c/h — HAL 层: Radio/Timer/PPI 配置
 *   ll_pdu.c/h    — 链路层 PDU 构造与校验
 *   adv.c/h       — 广播状态机 (SW TIFS ADV_IND + SCAN_RSP)
 *   main.c        — 全局变量定义与主入口
 *
 * SPDX-License-Identifier: Apache-2.0
 */

#include "ble_common.h"
#include "hal_radio.h"
#include "ll_pdu.h"
#include "adv.h"

/*===========================================================================
 * 全局变量定义
 *===========================================================================*/

const uint8_t adv_addr[BDADDR_SIZE] = {
	0x11, 0x22, 0x33, 0x44, 0x55, 0x66
};

/* PDU 缓冲区 */
struct pdu_adv pdu_adv_ind __aligned(4);
struct pdu_adv pdu_scan_rsp __aligned(4);
struct pdu_adv pdu_rx_buf __aligned(4);

/* 统计计数器 */
volatile uint32_t adv_event_count;
volatile uint32_t scan_req_count;
volatile uint32_t scan_rsp_count;

/*===========================================================================
 * 主函数
 *===========================================================================*/
int main(void)
{
	printk("\n=== BLE PHY SW TIFS Demo ===\n");
	printk("使用 TIMER1 + PPI 实现软件 TIFS 定时\n");
	printk("对应真实 Controller 的 !CONFIG_BT_CTLR_TIFS_HW 路径\n\n");

	hfclk_start();
	radio_configure();
	sw_switch_timer_configure();
	ppi_configure();
	build_adv_ind_pdu();
	build_scan_rsp_pdu();

	adv_init();
	adv_start();

	printk("Advertising started (SW TIFS mode: TIMER1 + PPI)\n\n");

	while (1) {
		k_sleep(K_SECONDS(5));
		printk("[Main] alive — adv: %u, scan_req: %u, scan_rsp: %u\n",
		       adv_event_count, scan_req_count, scan_rsp_count);
	}

	return 0;
}
```

## src/adv.c
```c
/*
 * BLE PHY 软件 TIFS Demo — 广播状态机
 *
 * SPDX-License-Identifier: Apache-2.0
 */

#include "adv.h"
#include "hal_radio.h"
#include "ll_pdu.h"

/*===========================================================================
 * 调度器组件
 *===========================================================================*/
static struct k_timer adv_timer;
static struct k_work  adv_work;

/*===========================================================================
 * 在指定信道上执行软件 TIFS 的 ADV_IND + SCAN_REQ + SCAN_RSP
 *
 * ★ 核心差异 vs phy_tifs_hw:
 *
 *   HW TIFS:
 *     NRF_RADIO->TIFS = 150;
 *     SHORTS = ... | DISABLED_RXEN;  // 硬件自动延时后切换
 *
 *   SW TIFS (本 Demo):
 *     TIMER1->CC[x] = TIFS - ramp_delay;  // 设置定时器
 *     PPI: TIMER1 CC[x] → RADIO TXEN/RXEN; // PPI 自动触发
 *     SHORTS = READY_START | END_DISABLE;   // 无 DISABLED→EN!
 *
 * 对比真实 Controller 的 sw_switch() 函数:
 *
 *   真实 Controller:                     本 Demo:
 *   ─────────────────────                ──────────────────
 *   nrf_timer_cc_set(SW_SWITCH_TIMER,    TIMER1->CC[0] = 110
 *     SW_SWITCH_TIMER_EVTS_COMP(toggle),
 *     tifs - delay);
 *
 *   hal_radio_rxen_on_sw_switch(cc,ppi)  PPI CH1: CC[0]→RXEN
 *   hal_radio_txen_on_sw_switch(cc,ppi)  PPI CH2: CC[1]→TXEN
 *
 *   sw_tifs_toggle ^= 1;                 (简化: 不使用 toggle)
 *
 * 关键区别: 真实 Controller 使用 toggle (交替 CC[0]/CC[1]) 和
 * PPI Groups 来避免陈旧 COMPARE 事件。我们通过在每次转换前
 * 清除 EVENTS_COMPARE 来达到同样的效果。
 *===========================================================================*/
static void adv_on_channel(uint32_t channel)
{
	uint32_t freq;

	switch (channel) {
	case 37: freq = 2;  break;
	case 38: freq = 26; break;
	case 39: freq = 80; break;
	default: return;
	}

	radio_freq_chan_set(freq);
	radio_whiten_iv_set(channel);
	NRF_RADIO->INTENCLR = 0xFFFFFFFFUL;

	/*==============================================================
	 * 第 1 阶段: TX ADV_IND
	 *
	 * 注意: PPI_CH_RXEN 在 TX 期间保持禁用!
	 * Timer + PPI_CH_TIMER_CLEAR 在 TX END 时清零 Timer。
	 * TX END 后才启用 PPI_CH_RXEN, 此时 Timer 从 0 开始计数,
	 * 110μs 后 RXEN 触发, Radio 进入 RX。
	 *==============================================================*/

	radio_pkt_tx_set(&pdu_adv_ind);

	radio_status_reset();
	NRF_RADIO->EVENTS_DISABLED = 0;
	NRF_RADIO->EVENTS_END = 0;
	NRF_RADIO->EVENTS_ADDRESS = 0;

	NRF_RADIO->SHORTS = RADIO_SHORTS_READY_START_Msk |
			    RADIO_SHORTS_END_DISABLE_Msk;

	/* 设置 CC 值 (TX→RX 和 RX→TX 阶段分别使用)
	 *
	 * CC[0] (TX→RX): ADV_IND TX END 后切 RX
	 *   TX END 事件与空口最后 bit 对齐 (无 chain delay)
	 *   CC[0] = T_IFS - RX_RAMP = 150 - 40 = 110μs
	 *
	 * CC[1] (RX→TX): SCAN_REQ RX END 后切 TX
	 *   RX END 事件比空口最后 bit 晚 RX_CHAIN_DELAY ≈ 10μs
	 *   必须补偿: CC[1] = T_IFS - TX_RAMP - RX_CHAIN_DELAY
	 *                    = 150 - 40 - 10 = 100μs
	 */
	nrf_timer_cc_set(NRF_TIMER1, (nrf_timer_cc_channel_t)CC_IDX_RXEN,
			 T_IFS_US - RX_RAMP_US);                       /* 110μs */
	nrf_timer_cc_set(NRF_TIMER1, (nrf_timer_cc_channel_t)CC_IDX_TXEN,
			 T_IFS_US - TX_RAMP_US - RX_CHAIN_DELAY_US);   /* 100μs */

	/* 确保 PPI_CH_RXEN 和 PPI_CH_TXEN 都禁用 (TX 期间不需要自动切换) */
	nrf_ppi_channels_disable(NRF_PPI, BIT(PPI_CH_RXEN) | BIT(PPI_CH_TXEN));

	/* 启动 Timer (PPI_CH_TIMER_CLEAR 始终启用: END→Timer CLEAR) */
	nrf_timer_task_trigger(NRF_TIMER1, NRF_TIMER_TASK_CLEAR);
	nrf_timer_task_trigger(NRF_TIMER1, NRF_TIMER_TASK_START);

	/* 开始 TX */
	NRF_RADIO->TASKS_TXEN = 1;

	/* 等待 TX END (ADV_IND 发送完毕)
	 * TX END 时: PPI_CH_TIMER_CLEAR 自动清零 Timer,
	 *           SHORTS END→DISABLE 使 Radio 进入 DISABLED。 */
	while (NRF_RADIO->EVENTS_END == 0) {
	}
	NRF_RADIO->EVENTS_END = 0;

	/*==============================================================
	 * 第 1.5 阶段: TX→RX 转换 (SW TIFS)
	 *
	 * TX END 发生时:
	 *   - PPI_CH_TIMER_CLEAR: Timer 清零到 0, 继续计数
	 *   - SHORTS: Radio END→DISABLE → DISABLED
	 *
	 * 现在启用 PPI_CH_RXEN:
	 *   Timer 从 0 计数, 在 CC[0]=110μs 时触发 RXEN
	 *   Radio DISABLED→RXRU (40μs)→RX, 总计 T_IFS=150μs
	 *
	 * ★ 关键: 先清除 EVENTS_COMPARE (带读回), 再启用 PPI
	 *   TX 期间 Timer 经过了 CC[0]=110μs (EVENTS_COMPARE[0]=1),
	 *   若不清除, PPI 启用后不会看到新的 0→1 边沿。
	 *==============================================================*/

	/* 清除 COMPARE 事件 (TX 期间的陈旧事件), 写后读回确保 APB 生效 */
	NRF_TIMER1->EVENTS_COMPARE[CC_IDX_RXEN] = 0;
	(void)NRF_TIMER1->EVENTS_COMPARE[CC_IDX_RXEN];
	NRF_TIMER1->EVENTS_COMPARE[CC_IDX_TXEN] = 0;
	(void)NRF_TIMER1->EVENTS_COMPARE[CC_IDX_TXEN];

	/* 切换 PACKETPTR 到 RX 缓冲区 */
	radio_pkt_rx_set(&pdu_rx_buf);

	/* 现在启用 PPI_CH_RXEN: Timer 正在从 TX END 清零后计数,
	 * 约 110μs 后 CC[0] 触发 RXEN */
	nrf_ppi_channels_enable(NRF_PPI, BIT(PPI_CH_RXEN));

	/* 等待 TX DISABLED */
	while (NRF_RADIO->EVENTS_DISABLED == 0) {
	}
	NRF_RADIO->EVENTS_DISABLED = 0;

	/*==============================================================
	 * 第 2 阶段: RX 等待 SCAN_REQ
	 *
	 * 此时: TIMER1 从 TX END 清零后正在计数。
	 *   - t = 0:     TX END, PPI 清零 Timer
	 *   - t ≈ 2μs:  EVENTS_COMPARE 清除 + PPI RXEN 启用
	 *   - t = 110μs: CC[0] 匹配 → PPI CH1 → RXEN 触发
	 *   - t = 150μs: RX READY → START, Radio 开始监听
	 *==============================================================*/

	/* ★ 必须清除 TX 期间设置的 ADDRESS 事件!
	 * EVENTS_ADDRESS 在 TX 时被硬件置 1 (Access Address 发送到空中时),
	 * 若不清除, 下方 RX 等待循环会立即退出, 永远收不到 SCAN_REQ。 */
	NRF_RADIO->EVENTS_ADDRESS = 0;

	/* 等待 ADDRESS 事件 (AA 匹配, 有扫描器在发包) */
	uint32_t timeout = RX_TIMEOUT_US * 16;
	while (NRF_RADIO->EVENTS_ADDRESS == 0 && timeout > 0) {
		timeout--;
	}

	if (NRF_RADIO->EVENTS_ADDRESS == 0) {
		/* 超时: 无 SCAN_REQ */
		radio_ensure_disabled();
		return;
	}

	/* ADDRESS 匹配!
	 *
	 * 现在 CC[0] 已经完成了使命 (RXEN 已触发), 可以安全禁用 PPI_CH_RXEN。
	 * 同时启用 PPI_CH_TXEN: CC[1]=100μs 将在 RX END 后触发 TXEN → SCAN_RSP。
	 *
	 * ★ FIX: CC[1] 已在 TX 开始前设置好 (= T_IFS - TX_RAMP - RX_CHAIN_DELAY = 100μs)。
	 *   不能在此处设置 CC[1]! 因为 ADDRESS 触发时 Timer ≈ 190μs > 100μs,
	 *   CC[1] 已被过去, 下次匹配要等到 Timer 溢出 (65535μs 后)。
	 *   CC[1] 必须在 RX END 时 PPI 清零 Timer 之后生效, 而 Timer 的零点是 RX END。
	 *   我们在 TX 前设置好的 CC[1]=100, 在 RX END + 100μs 时自然触发。
	 *
	 * 对应真实 Controller:
	 *   sw_switch(SW_SWITCH_RX, SW_SWITCH_TX, phy_rx, ...);
	 *   → hal_radio_txen_on_sw_switch(cc, ppi)  (CC 已由 radio_tmr_tifs_set 设置)
	 */
	nrf_ppi_channels_disable(NRF_PPI, BIT(PPI_CH_RXEN));
	nrf_ppi_channels_enable(NRF_PPI, BIT(PPI_CH_TXEN));

	/* 等待 RX END (SCAN_REQ 接收完毕)
	 * SHORTS: END→DISABLE, PPI: END→TIMER CLEAR */
	while (NRF_RADIO->EVENTS_END == 0) {
	}
	NRF_RADIO->EVENTS_END = 0;

	/* RX END 后:
	 * - SHORTS: END→DISABLE → Radio DISABLED
	 * - PPI CH0: END → TIMER CLEAR → Timer 从 0 开始计数
	 * - t = 110μs 时: CC[1] → PPI CH2 (TXEN 已启用) → TXEN 触发 → TX SCAN_RSP
	 *
	 * ★ 必须清除两个 CC 事件!
	 * RX 期间 Timer 已计过 CC[0] 和 CC[1] (均为 110μs, RX 过 200μs 时已过)。
	 * 不清除的话 CC[1] 无法产生新的 0→1 边沿, PPI 不会触发 TXEN。
	 *
	 * ★ 写后读回确保 APB 写入生效 */
	NRF_TIMER1->EVENTS_COMPARE[CC_IDX_TXEN] = 0;
	(void)NRF_TIMER1->EVENTS_COMPARE[CC_IDX_TXEN];
	NRF_TIMER1->EVENTS_COMPARE[CC_IDX_RXEN] = 0;
	(void)NRF_TIMER1->EVENTS_COMPARE[CC_IDX_RXEN];

	/* 验证 SCAN_REQ
	 * 此时距 RX END ~5μs, 距 PPI 触发 TXEN 还有 ~105μs */
	if (!radio_crc_is_valid() || !validate_scan_req(&pdu_rx_buf)) {
		/* 无效: 禁用 TXEN PPI, 取消 TX 转换 */
		radio_ensure_disabled();
		return;
	}

	scan_req_count++;

	/*==============================================================
	 * 第 3 阶段: TX SCAN_RSP (由 SW TIFS PPI 自动触发)
	 *
	 * 时序 (从 RX END 开始, t=0):
	 *   t = 0:     RX END, PPI 清零 Timer → Timer 从 0 计数
	 *   t ≈ 1μs:  RX DISABLED (SHORTS END→DISABLE)
	 *   t ≈ 5μs:  验证 SCAN_REQ 完成 (我们在这里)
	 *   t = 100μs: CC[1] 匹配 → PPI CH2 → TXEN (Radio 从 DISABLED 进入 TXRU)
	 *   t = 140μs: TX READY → (SHORTS READY→START) → TX 开始
	 *   t ≈ 540μs: TX END → DISABLED
	 *
	 * 空口 T_IFS = 100 + 40 + RX_CHAIN_DELAY(10) = 150μs ✓
	 *
	 * 我们需要在 t=100μs 前完成: radio_pkt_tx_set + SHORTS 设置 + 清除事件。
	 * 有 ~95μs 的充足时间。
	 *==============================================================*/

	radio_pkt_tx_set(&pdu_scan_rsp);

	/* SHORTS: TX 完成后 DISABLE */
	NRF_RADIO->SHORTS = RADIO_SHORTS_READY_START_Msk |
			    RADIO_SHORTS_END_DISABLE_Msk;

	NRF_RADIO->EVENTS_END = 0;
	NRF_RADIO->EVENTS_DISABLED = 0;  /* ★ 必须清除: RX SHORTS 产生的 DISABLED 事件 */

	/* 等待 PPI 自动触发 TXEN → TX 完成后 DISABLED */
	while (NRF_RADIO->EVENTS_DISABLED == 0) {
	}

	/* 清理: 禁用 TXEN PPI */
	nrf_ppi_channels_disable(NRF_PPI, BIT(PPI_CH_TXEN));
	NRF_RADIO->SHORTS = 0;

	scan_rsp_count++;
}

/*===========================================================================
 * 广播工作处理函数
 *===========================================================================*/
void adv_worker(struct k_work *work)
{
	ARG_UNUSED(work);

	adv_on_channel(37);
	adv_on_channel(38);
	adv_on_channel(39);

	adv_event_count++;

	if (adv_event_count <= 3 || adv_event_count % 10 == 0) {
		printk("[SW-TIFS] events: %u | SCAN_REQ rx: %u | SCAN_RSP tx: %u\n",
		       adv_event_count, scan_req_count, scan_rsp_count);
	}
}

/*===========================================================================
 * 定时器回调
 *===========================================================================*/
void adv_timer_expiry(struct k_timer *timer)
{
	ARG_UNUSED(timer);
	k_work_submit(&adv_work);
}

/*===========================================================================
 * 初始化调度器组件
 *===========================================================================*/
void adv_init(void)
{
	k_work_init(&adv_work, adv_worker);
	k_timer_init(&adv_timer, adv_timer_expiry, NULL);
}

/*===========================================================================
 * 启动广播定时器
 *===========================================================================*/
void adv_start(void)
{
	k_timer_start(&adv_timer, K_NO_WAIT, K_MSEC(ADV_INTERVAL_MS));
}
```

## src/adv.h
```c
/*
 * BLE PHY 软件 TIFS Demo — 广播状态机
 *
 * SPDX-License-Identifier: Apache-2.0
 */

#ifndef ADV_H
#define ADV_H

#include "ble_common.h"

/* 广播工作处理函数 (系统工作队列回调) */
void adv_worker(struct k_work *work);

/* 定时器到期回调 */
void adv_timer_expiry(struct k_timer *timer);

/* 初始化调度器组件 (k_work + k_timer) */
void adv_init(void);

/* 启动广播定时器 */
void adv_start(void);

#endif /* ADV_H */
```

## src/ble_common.h
```c
/*
 * BLE PHY 软件 TIFS Demo — 公共类型、常量与全局变量声明
 *
 * SPDX-License-Identifier: Apache-2.0
 */

#ifndef BLE_COMMON_H
#define BLE_COMMON_H

#include <zephyr/kernel.h>
#include <zephyr/sys/printk.h>
#include <zephyr/sys/byteorder.h>
#include <string.h>
#include <soc.h>
#include <hal/nrf_clock.h>
#include <hal/nrf_timer.h>
#include <hal/nrf_ppi.h>

/* ---- Controller HAL 层头文件 ---- */
#include "hal/ccm.h"       /* struct ccm (需在 radio.h 之前) */
#include "hal/radio.h"     /* radio_phy_set, radio_aa_set, ... */

/* ---- Controller PDU 结构体定义 ---- */
#include "pdu_df.h"        /* struct pdu_cte_info */
#include "pdu_vendor.h"    /* Nordic 特定的 PDU 扩展 */
#include "pdu.h"           /* struct pdu_adv, PDU_AC_ACCESS_ADDR, ... */

/*===========================================================================
 * 配置参数
 *===========================================================================*/

#define ADV_INTERVAL_MS  100

/* T_IFS: BLE 规范定义的帧间间隔 = 150 μs */
#define T_IFS_US         150

/* RX ramp-up 延迟 (μs): RXEN → READY → START ≈ 40 μs */
#define RX_RAMP_US       40

/* TX ramp-up 延迟 (μs): TXEN → READY → START ≈ 40 μs */
#define TX_RAMP_US       40

/* RX chain delay (μs): 空口最后一个 bit → EVENTS_END 之间的内部处理延迟
 * nRF52832 1M PHY ≈ 10 μs (数据来源: nRF52832 Product Specification,
 * RADIO Timing, "Time from last bit on air to END event")
 * TX END 无此延迟: END 事件与最后 bit 对齐。 */
#define RX_CHAIN_DELAY_US  10

/* RX 超时 (μs) */
#define RX_TIMEOUT_US    500

/* 广播设备名称 */
#define ADV_NAME         "ZephyrSW"

/*===========================================================================
 * PPI 通道分配
 *
 * nRF52840 有 20 个可编程 PPI 通道 (0-19)。
 * 真实 Controller 使用通道 0-7, 我们使用高编号避免冲突。
 *===========================================================================*/
#define PPI_CH_TIMER_CLEAR  14   /* RADIO END → TIMER1 CLEAR */
#define PPI_CH_RXEN         15   /* TIMER1 CC[0] → RADIO RXEN */
#define PPI_CH_TXEN         16   /* TIMER1 CC[1] → RADIO TXEN */

/* Timer CC 通道 */
#define CC_IDX_RXEN  0   /* TX→RX 转换 */
#define CC_IDX_TXEN  1   /* RX→TX 转换 */

/*===========================================================================
 * 全局变量声明 (定义在 main.c)
 *===========================================================================*/

extern const uint8_t adv_addr[BDADDR_SIZE];

/* PDU 缓冲区 */
extern struct pdu_adv pdu_adv_ind;
extern struct pdu_adv pdu_scan_rsp;
extern struct pdu_adv pdu_rx_buf;

/* 统计计数器 */
extern volatile uint32_t adv_event_count;
extern volatile uint32_t scan_req_count;
extern volatile uint32_t scan_rsp_count;

#endif /* BLE_COMMON_H */
```

## src/hal_radio.c
```c
/*
 * BLE PHY 软件 TIFS Demo — HAL 层: 硬件初始化与 Radio/Timer/PPI 配置
 *
 * SPDX-License-Identifier: Apache-2.0
 */

#include "hal_radio.h"

/*===========================================================================
 * 启动 HFCLK
 *===========================================================================*/
void hfclk_start(void)
{
	NRF_CLOCK->EVENTS_HFCLKSTARTED = 0;
	NRF_CLOCK->TASKS_HFCLKSTART = 1;
	while (NRF_CLOCK->EVENTS_HFCLKSTARTED == 0) {
	}
	printk("HFCLK started\n");
}

/*===========================================================================
 * 配置 RADIO (注意: 不设置 NRF_RADIO->TIFS!)
 *===========================================================================*/
void radio_configure(void)
{
	/* 清除所有 Radio 中断 */
	NRF_RADIO->INTENCLR = 0xFFFFFFFFUL;
	NRF_RADIO->SHORTS = 0;

	radio_phy_set(0, 0);
	radio_tx_power_set(0);

	radio_pkt_configure(RADIO_PKT_CONF_LENGTH_8BIT,
			    PDU_AC_LEG_PAYLOAD_SIZE_MAX,
			    RADIO_PKT_CONF_FLAGS(
				    RADIO_PKT_CONF_PDU_TYPE_AC,
				    RADIO_PKT_CONF_PHY_LEGACY,
				    RADIO_PKT_CONF_CTE_DISABLED));

	uint32_t aa = sys_cpu_to_le32(PDU_AC_ACCESS_ADDR);
	radio_aa_set((const uint8_t *)&aa);
	radio_crc_configure(PDU_CRC_POLYNOMIAL, PDU_AC_CRC_IV);

	/* ★ 注意: SW TIFS 模式下不使用 NRF_RADIO->TIFS 寄存器!
	 * TIFS 完全由 TIMER1 + PPI 控制。
	 * 清零 TIFS 寄存器确保不会意外影响时序。 */
	NRF_RADIO->TIFS = 0;

	printk("Radio configured: BLE 1M (SW TIFS mode, TIFS register=0)\n");
}

/*===========================================================================
 * 配置 SW_SWITCH_TIMER (NRF_TIMER1)
 *
 * 在真实 Controller 中:
 *   SW_SWITCH_TIMER = NRF_TIMER1 (非 single-timer 模式)
 *   radio_tmr_start() 中配置:
 *     SW_SWITCH_TIMER->MODE = 0;          (Timer mode)
 *     SW_SWITCH_TIMER->PRESCALER = 4;     (1MHz, 1μs)
 *     SW_SWITCH_TIMER->BITMODE = 0;       (16-bit)
 *===========================================================================*/
void sw_switch_timer_configure(void)
{
	/* 停止 Timer1 以便安全配置 */
	nrf_timer_task_trigger(NRF_TIMER1, NRF_TIMER_TASK_STOP);
	nrf_timer_task_trigger(NRF_TIMER1, NRF_TIMER_TASK_CLEAR);

	/* 禁用 Timer1 所有中断 */
	NRF_TIMER1->INTENCLR = 0xFFFFFFFFUL;

	/* 清除所有 CC 比较事件 */
	for (int i = 0; i < 6; i++) {
		NRF_TIMER1->EVENTS_COMPARE[i] = 0;
	}

	/* Timer 模式, 1MHz 精度 (16MHz / 2^4 = 1MHz → 1μs 分辨率) */
	NRF_TIMER1->MODE      = TIMER_MODE_MODE_Timer;
	NRF_TIMER1->PRESCALER = 4;
	NRF_TIMER1->BITMODE   = TIMER_BITMODE_BITMODE_16Bit;

	printk("SW_SWITCH_TIMER (TIMER1) configured: 1MHz, 16-bit\n");
}

/*===========================================================================
 * 配置 PPI 通道
 *
 * 在真实 Controller 中 (nRF52, PPI 架构):
 *
 *   hal_sw_switch_timer_clear_ppi_config():
 *     PPI: RADIO END → TIMER CLEAR
 *
 *   hal_radio_txen_on_sw_switch(cc, ppi):
 *     PPI: TIMER COMPARE[cc] → RADIO TXEN
 *
 *   hal_radio_rxen_on_sw_switch(cc, ppi):
 *     PPI: TIMER COMPARE[cc] → RADIO RXEN
 *
 * 我们的简化版本:
 *   - 不使用 PPI Groups (真实 Controller 用 Groups 管理 toggle)
 *   - 直接通过 CHENSET/CHENCLR 启停 PPI 通道
 *===========================================================================*/
void ppi_configure(void)
{
	/* PPI CH0: RADIO EVENTS_END → TIMER1 TASKS_CLEAR
	 *
	 * 功能: 每当 Radio 包传输/接收结束 (END event),
	 *        PPI 自动将 TIMER1 清零到 0 并开始重新计数。
	 *        这是 SW TIFS 的时间基准: t=0 从包结束时刻开始。
	 *
	 * 对应真实 Controller:
	 *   hal_sw_switch_timer_clear_ppi_config()
	 */
	nrf_ppi_channel_endpoint_setup(
		NRF_PPI,
		(nrf_ppi_channel_t)PPI_CH_TIMER_CLEAR,
		(uint32_t)&NRF_RADIO->EVENTS_END,
		(uint32_t)&NRF_TIMER1->TASKS_CLEAR);

	/* PPI CH1: TIMER1 EVENTS_COMPARE[0] → RADIO TASKS_RXEN
	 *
	 * 功能: 当 TIMER1 计数到 CC[0] 时, PPI 自动触发 Radio RXEN。
	 *        用于 TX→RX 转换 (ADV_IND TX 结束后启动 RX 接收 SCAN_REQ)。
	 *
	 * CC[0] = T_IFS - RX_ramp_delay
	 *       = 150 - 40 = 110 μs
	 *
	 * 对应真实 Controller:
	 *   hal_radio_rxen_on_sw_switch(cc, ppi)
	 */
	nrf_ppi_channel_endpoint_setup(
		NRF_PPI,
		(nrf_ppi_channel_t)PPI_CH_RXEN,
		(uint32_t)&NRF_TIMER1->EVENTS_COMPARE[CC_IDX_RXEN],
		(uint32_t)&NRF_RADIO->TASKS_RXEN);

	/* PPI CH2: TIMER1 EVENTS_COMPARE[1] → RADIO TASKS_TXEN
	 *
	 * 功能: 当 TIMER1 计数到 CC[1] 时, PPI 自动触发 Radio TXEN。
	 *        用于 RX→TX 转换 (SCAN_REQ RX 结束后启动 TX 发送 SCAN_RSP)。
	 *
	 * CC[1] = T_IFS - TX_ramp_delay - RX_chain_delay
	 *       = 150 - 40 - 10 = 100 μs
	 *
	 * RX END 事件比空口最后 bit 晚 RX_chain_delay ≈ 10μs,
	 * 必须从 CC 值中扣除, 否则空口 T_IFS 会偏大 10μs。
	 *
	 * 对应真实 Controller:
	 *   hal_radio_txen_on_sw_switch(cc, ppi)
	 */
	nrf_ppi_channel_endpoint_setup(
		NRF_PPI,
		(nrf_ppi_channel_t)PPI_CH_TXEN,
		(uint32_t)&NRF_TIMER1->EVENTS_COMPARE[CC_IDX_TXEN],
		(uint32_t)&NRF_RADIO->TASKS_TXEN);

	/* 仅启用 Timer Clear PPI (常开), 其他两个按需启用 */
	nrf_ppi_channels_enable(NRF_PPI, BIT(PPI_CH_TIMER_CLEAR));
	nrf_ppi_channels_disable(NRF_PPI, BIT(PPI_CH_RXEN) | BIT(PPI_CH_TXEN));

	printk("PPI configured:\n");
	printk("  CH%d: RADIO END → TIMER1 CLEAR\n", PPI_CH_TIMER_CLEAR);
	printk("  CH%d: TIMER1 CC[%d] → RADIO RXEN\n", PPI_CH_RXEN, CC_IDX_RXEN);
	printk("  CH%d: TIMER1 CC[%d] → RADIO TXEN\n", PPI_CH_TXEN, CC_IDX_TXEN);
}

/*===========================================================================
 * 确保 Radio 回到 DISABLED 状态
 *===========================================================================*/
void radio_ensure_disabled(void)
{
	NRF_RADIO->SHORTS = 0;

	/* 禁用自动切换 PPI, 防止 Timer CC 匹配后触发 RXEN/TXEN */
	nrf_ppi_channels_disable(NRF_PPI, BIT(PPI_CH_RXEN) | BIT(PPI_CH_TXEN));

	/* 停止 Timer, 防止 CC 事件在空闲期间持续触发 */
	nrf_timer_task_trigger(NRF_TIMER1, NRF_TIMER_TASK_STOP);

	if (NRF_RADIO->STATE != RADIO_STATE_STATE_Disabled) {
		NRF_RADIO->EVENTS_DISABLED = 0;
		NRF_RADIO->TASKS_DISABLE = 1;
		while (NRF_RADIO->EVENTS_DISABLED == 0) {
		}
	}
}
```

## src/hal_radio.h
```c
/*
 * BLE PHY 软件 TIFS Demo — HAL 层: 硬件初始化与 Radio/Timer/PPI 配置
 *
 * SPDX-License-Identifier: Apache-2.0
 */

#ifndef HAL_RADIO_INIT_H
#define HAL_RADIO_INIT_H

#include "ble_common.h"

/* 硬件初始化 */
void hfclk_start(void);
void radio_configure(void);

/* SW TIFS 基础设施 */
void sw_switch_timer_configure(void);
void ppi_configure(void);

/* Radio 状态管理 */
void radio_ensure_disabled(void);

#endif /* HAL_RADIO_INIT_H */
```

## src/ll_pdu.c
```c
/*
 * BLE PHY 软件 TIFS Demo — 链路层 PDU 构造与校验
 *
 * SPDX-License-Identifier: Apache-2.0
 */

#include "ll_pdu.h"

/*===========================================================================
 * AD 数据
 *===========================================================================*/
static const uint8_t adv_data[] = {
	0x02, 0x01, 0x06,
	0x09, 0x09, 'Z', 'e', 'p', 'h', 'y', 'r', 'S', 'W'
};
#define ADV_DATA_LEN sizeof(adv_data)

static const uint8_t scan_rsp_data[] = {
	0x11, 0x09, 'Z', 'e', 'p', 'h', 'y', 'r', 'S', 'W',
	             '-', 'S', 'c', 'a', 'n', 'R', 's', 'p',
};
#define SCAN_RSP_DATA_LEN sizeof(scan_rsp_data)

/*===========================================================================
 * 构造 PDU
 *===========================================================================*/
void build_adv_ind_pdu(void)
{
	memset(&pdu_adv_ind, 0, sizeof(pdu_adv_ind));
	pdu_adv_ind.type    = PDU_ADV_TYPE_ADV_IND;
	pdu_adv_ind.tx_addr = 1;
	pdu_adv_ind.rx_addr = 0;
	pdu_adv_ind.len     = BDADDR_SIZE + ADV_DATA_LEN;
	memcpy(pdu_adv_ind.adv_ind.addr, adv_addr, BDADDR_SIZE);
	memcpy(pdu_adv_ind.adv_ind.data, adv_data, ADV_DATA_LEN);
	printk("ADV_IND PDU built: type=0x%02X len=%d\n",
	       pdu_adv_ind.type, pdu_adv_ind.len);
}

void build_scan_rsp_pdu(void)
{
	memset(&pdu_scan_rsp, 0, sizeof(pdu_scan_rsp));
	pdu_scan_rsp.type    = PDU_ADV_TYPE_SCAN_RSP;
	pdu_scan_rsp.tx_addr = 1;
	pdu_scan_rsp.rx_addr = 0;
	pdu_scan_rsp.len     = BDADDR_SIZE + SCAN_RSP_DATA_LEN;
	memcpy(pdu_scan_rsp.scan_rsp.addr, adv_addr, BDADDR_SIZE);
	memcpy(pdu_scan_rsp.scan_rsp.data, scan_rsp_data, SCAN_RSP_DATA_LEN);
	printk("SCAN_RSP PDU built: type=0x%02X len=%d\n",
	       pdu_scan_rsp.type, pdu_scan_rsp.len);
}

/*===========================================================================
 * 验证 SCAN_REQ
 *===========================================================================*/
bool validate_scan_req(const struct pdu_adv *rx_pdu)
{
	if (rx_pdu->type != PDU_ADV_TYPE_SCAN_REQ) {
		return false;
	}
	if (rx_pdu->len != sizeof(struct pdu_adv_scan_req)) {
		return false;
	}
	if (memcmp(rx_pdu->scan_req.adv_addr, adv_addr, BDADDR_SIZE) != 0) {
		return false;
	}
	return true;
}
```

## src/ll_pdu.h
```c
/*
 * BLE PHY 软件 TIFS Demo — 链路层 PDU 构造与校验
 *
 * SPDX-License-Identifier: Apache-2.0
 */

#ifndef LL_PDU_H
#define LL_PDU_H

#include "ble_common.h"

/* PDU 构造 */
void build_adv_ind_pdu(void);
void build_scan_rsp_pdu(void);

/* SCAN_REQ 校验 */
bool validate_scan_req(const struct pdu_adv *rx_pdu);

#endif /* LL_PDU_H */
```
