## CMakeLists.txt
```
# SPDX-License-Identifier: Apache-2.0

cmake_minimum_required(VERSION 3.20.0)
find_package(Zephyr REQUIRED HINTS $ENV{ZEPHYR_BASE})
project(ble_phy_connect_ind)

target_sources(app PRIVATE
  src/main.c
  src/hal_radio.c
  src/ll_pdu.c
  src/adv.c
)

# Add BLE controller internal include paths so we can use HAL APIs and PDU structs
target_include_directories(app PRIVATE
  # controller root — resolves "hal/radio.h" -> controller/hal/radio.h (redirect)
  ${ZEPHYR_BASE}/subsys/bluetooth/controller
  # controller/include — resolves "ll.h" etc.
  ${ZEPHYR_BASE}/subsys/bluetooth/controller/include
  # Nordic vendor — resolves "hal/radio_vendor_hal.h" -> "hal/nrf5/radio/radio.h"
  ${ZEPHYR_BASE}/subsys/bluetooth/controller/ll_sw/nordic
  # ll_sw — resolves "pdu.h", "pdu_df.h"
  ${ZEPHYR_BASE}/subsys/bluetooth/controller/ll_sw
  # Nordic LLL — resolves "pdu_vendor.h"
  ${ZEPHYR_BASE}/subsys/bluetooth/controller/ll_sw/nordic/lll
)
```

## prj.conf
```kconfig
# BLE PHY CONNECT_IND Demo
# 解析连接请求: 从 CONNECT_IND 中提取连接参数

CONFIG_GPIO=y
CONFIG_SERIAL=y
CONFIG_CONSOLE=y
CONFIG_UART_CONSOLE=y
CONFIG_PRINTK=y

# 启用 BLE Controller (Split Link Layer) — 编译 HAL 代码
CONFIG_BT=y
CONFIG_BT_LL_SW_SPLIT=y
CONFIG_BT_BROADCASTER=y
CONFIG_BT_PERIPHERAL=y

# 不需要 Host 层功能
CONFIG_BT_OBSERVER=n
CONFIG_BT_CENTRAL=n
```

## src/main.c
```c
/*
 * BLE PHY CONNECT_IND 解析 Demo
 *
 * 本 Demo 专注于 BLE 连接建立的第一步 —— 接收和解析 CONNECT_IND。
 *
 * ┌ ─ ─ ─ ─ ─ ─ ─ ─ ─ ─ ─ ─ ─ ─ ─ ─ ─ ─ ─ ─ ─ ─ ─ ─ ─ ─ ─ ─ ─ ─ ─ ┐
 * │ 什么是 CONNECT_IND?                                                   │
 * │                                                                       │
 * │ CONNECT_IND 是 Master 发给 Slave 的连接请求包, 包含建立连接所需的     │
 * │ 全部参数: Access Address, CRC 初始值, 连接间隔, 跳频参数等。          │
 * │                                                                       │
 * │ Core Spec Vol 6, Part B, Section 2.3.3.1:                             │
 * │   InitA(6) + AdvA(6) + LLData(22) = 34 字节                          │
 * │                                                                       │
 * │ LLData 包含 12 个字段:                                                │
 * │   AA, CRCInit, WinSize, WinOffset, Interval, Latency, Timeout,       │
 * │   ChM, Hop, SCA                                                       │
 * └ ─ ─ ─ ─ ─ ─ ─ ─ ─ ─ ─ ─ ─ ─ ─ ─ ─ ─ ─ ─ ─ ─ ─ ─ ─ ─ ─ ─ ─ ─ ─ ┘
 *
 * 时序:
 *
 *   Slave                               Master
 *    │                                    │
 *    │──── ADV_IND (ch 37/38/39) ───────>│
 *    │                                    │
 *    │<──── CONNECT_IND (T_IFS=150μs) ───│
 *    │        [T0 = RTC0 timestamp]       │
 *    │                                    │
 *    │  解析 LLData → print_connect_ind() │
 *    │                                    │
 *    │  (本例程不进入连接态, 打印后回到广播)│
 *
 * 代码结构:
 *   ble_common.h  — 公共类型、常量 (新增 struct conn_param)
 *   hal_radio.c/h — HAL 层 (新增 rtc0_start)
 *   ll_pdu.c/h    — PDU 构造 (新增 CONNECT_IND 解析与打印)
 *   adv.c/h       — 广播态 (改为等待 CONNECT_IND, 不再处理 SCAN_REQ)
 *   main.c        — 主状态机: ADV → CONNECT_IND → 打印 → ADV
 *
 * SPDX-License-Identifier: Apache-2.0
 */

#include "ble_common.h"
#include "hal_radio.h"
#include "ll_pdu.h"
#include "adv.h"

/*===========================================================================
 * 全局变量定义
 *===========================================================================*/

const uint8_t adv_addr[BDADDR_SIZE] = {
	0x11, 0x22, 0x33, 0x44, 0x55, 0x66
};

const uint8_t adv_data[] = {
	0x02, 0x01, 0x06,
	0x08, 0x09, 'C', 'o', 'n', 'n', 'I', 'n', 'd'
};

struct conn_param conn_params;

/* PDU 缓冲区 */
struct pdu_adv pdu_adv_ind __aligned(4);
struct pdu_adv pdu_adv_rx __aligned(4);

/* CONNECT_IND 接收时刻 (NRF_RTC0 Counter) — 这就是 "T0" */
uint32_t connect_end_rtc;

/* SCA PPM 映射表 (BLE Core Spec Vol 6, Part B, 4.5.7, Table 4.1) */
const uint16_t sca_ppm_table[] = {500, 250, 150, 100, 75, 50, 30, 20};

/* 统计 */
volatile uint32_t adv_event_count;

/*===========================================================================
 * 主函数
 *===========================================================================*/
int main(void)
{
	printk("\n");
	printk("===================================================\n");
	printk("  BLE PHY CONNECT_IND Demo\n");
	printk("  解析连接请求中的 12 个参数字段\n");
	printk("===================================================\n");
	printk("Device: %s  Addr: %02X:%02X:%02X:%02X:%02X:%02X\n",
	       ADV_NAME,
	       adv_addr[5], adv_addr[4], adv_addr[3],
	       adv_addr[2], adv_addr[1], adv_addr[0]);
	printk("\n");

	hfclk_start();
	rtc0_start();
	sw_switch_timer_configure();
	ppi_configure();

	while (1) {
		printk("[STATE] Entering ADVERTISING state\n");
		adv_event_count = 0;

		radio_configure_adv();
		build_adv_ind_pdu();

		bool connected = false;

		while (!connected) {
			int ret = adv_event();

			if (ret == 1) {
				connected = true;
			} else {
				k_msleep(ADV_INTERVAL_MS);
			}
		}

		/* ★ 收到 CONNECT_IND! 打印解析结果 */
		print_connect_ind();

		printk("\n[STATE] CONNECT_IND parsed. "
		       "(Not entering connection state in this demo)\n");
		printk("[STATE] Returning to advertising...\n\n");

		radio_ensure_disabled();
		k_msleep(100);
	}

	return 0;
}
```

## src/adv.c
```c
/*
 * BLE PHY CONNECT_IND Demo — 广播态: ADV_IND 发送与 CONNECT_IND 接收
 *
 * 相比 02_tifs_scan 的 adv.c, 关键变化:
 *   - TX ADV_IND 后等待的不再是 SCAN_REQ, 而是 CONNECT_IND
 *   - RX 完成后立即读取 NRF_RTC0->COUNTER 捕获 T0
 *   - 验证成功后调用 parse_connect_ind() 提取参数
 *   - 返回值: 1=收到 CONNECT_IND, 0=未收到
 *
 * SPDX-License-Identifier: Apache-2.0
 */

#include "adv.h"
#include "hal_radio.h"
#include "ll_pdu.h"

/*===========================================================================
 * 广播信道处理
 *===========================================================================*/
int adv_on_channel(uint32_t channel)
{
	uint32_t freq;

	switch (channel) {
	case 37: freq = 2;  break;
	case 38: freq = 26; break;
	case 39: freq = 80; break;
	default: return 0;
	}

	radio_freq_chan_set(freq);
	radio_whiten_iv_set(channel);

	NRF_RADIO->INTENCLR = 0xFFFFFFFFUL;

	/*==============================================================
	 * 第 1 阶段: TX ADV_IND (SW TIFS)
	 *
	 * PPI_CH_RXEN 在 TX 期间保持禁用!
	 * TX END 时 PPI_CH_TIMER_CLEAR 清零 Timer1。
	 * TX END 后启用 PPI_CH_RXEN, 110μs 后 RXEN 触发。
	 *==============================================================*/

	radio_pkt_tx_set(&pdu_adv_ind);

	radio_status_reset();
	NRF_RADIO->EVENTS_DISABLED = 0;
	NRF_RADIO->EVENTS_END = 0;
	NRF_RADIO->EVENTS_ADDRESS = 0;

	/* SW TIFS: 不使用 DISABLED_RXEN SHORT */
	NRF_RADIO->SHORTS = RADIO_SHORTS_READY_START_Msk |
			    RADIO_SHORTS_END_DISABLE_Msk;

	nrf_timer_cc_set(NRF_TIMER1, (nrf_timer_cc_channel_t)CC_IDX_RXEN,
			 T_IFS_US - RX_RAMP_US);
	nrf_ppi_channels_disable(NRF_PPI, BIT(PPI_CH_RXEN) | BIT(PPI_CH_TXEN));

	nrf_timer_task_trigger(NRF_TIMER1, NRF_TIMER_TASK_CLEAR);
	nrf_timer_task_trigger(NRF_TIMER1, NRF_TIMER_TASK_START);

	NRF_RADIO->TASKS_TXEN = 1;

	/* 等待 TX END */
	while (NRF_RADIO->EVENTS_END == 0) {
	}
	NRF_RADIO->EVENTS_END = 0;

	/*==============================================================
	 * TX→RX 转换 (SW TIFS)
	 *
	 * TX END 时 PPI 清零 Timer1, 从 0 开始计数。
	 * 清除陈旧 COMPARE 事件, 切换到 RX 缓冲区, 启用 PPI_CH_RXEN。
	 * 110μs 后 CC[0] 触发 RXEN → 40μs ramp → RX START (T_IFS=150μs)
	 *==============================================================*/

	NRF_TIMER1->EVENTS_COMPARE[CC_IDX_RXEN] = 0;
	(void)NRF_TIMER1->EVENTS_COMPARE[CC_IDX_RXEN];

	radio_pkt_rx_set(&pdu_adv_rx);

	nrf_ppi_channels_enable(NRF_PPI, BIT(PPI_CH_RXEN));

	/* 等待 TX DISABLED */
	while (NRF_RADIO->EVENTS_DISABLED == 0) {
	}
	NRF_RADIO->EVENTS_DISABLED = 0;

	/*==============================================================
	 * 第 2 阶段: RX 等待 CONNECT_IND
	 *
	 * ★ 必须清除 TX 期间的 ADDRESS 事件!
	 * EVENTS_ADDRESS 在 TX 时被硬件置 1 (AA 发送到空中时),
	 * 若不清除, 后续逻辑会误判为已收到包。
	 *==============================================================*/

	NRF_RADIO->EVENTS_ADDRESS = 0;

	uint32_t timeout_loops = ADV_RX_TIMEOUT_US * 16;
	bool rx_done = false;

	while (timeout_loops > 0) {
		if (NRF_RADIO->EVENTS_DISABLED) {
			rx_done = true;
			break;
		}
		timeout_loops--;
	}

	/* ★ 关键时刻: 立即捕获 T0 — CONNECT_IND 结束时的 RTC0 tick
	 *
	 * 必须在 CRC 检查和 validate 之前读取, 减少软件延迟!
	 * 这个值是整个锚点体系的基准, 所有后续连接事件
	 * 的定时都从这个 T0 开始推算。
	 *
	 * 在 Zephyr 控制器中:
	 *   ftr->ticks_anchor = radio_tmr_start_get() */
	uint32_t rx_end_rtc = NRF_RTC0->COUNTER & HAL_TICKER_CNTR_MASK;

	if (!rx_done) {
		radio_ensure_disabled();
		return 0;
	}

	nrf_ppi_channels_disable(NRF_PPI, BIT(PPI_CH_RXEN));
	NRF_RADIO->SHORTS = 0;

	if (!radio_crc_is_valid()) {
		return 0;
	}

	if (validate_connect_ind(&pdu_adv_rx)) {
		connect_end_rtc = rx_end_rtc;
		parse_connect_ind(&pdu_adv_rx);
		return 1;
	}

	return 0;
}

/*===========================================================================
 * 广播事件
 *===========================================================================*/
int adv_event(void)
{
	static const uint32_t adv_channels[] = {37, 38, 39};

	for (int i = 0; i < 3; i++) {
		int ret = adv_on_channel(adv_channels[i]);

		if (ret == 1) {
			return 1;
		}
	}

	adv_event_count++;
	if (adv_event_count <= 3 || adv_event_count % 50 == 0) {
		printk("[ADV] events: %u (waiting for connection...)\n",
		       adv_event_count);
	}
	return 0;
}
```

## src/adv.h
```c
/*
 * BLE PHY CONNECT_IND Demo — 广播态
 *
 * SPDX-License-Identifier: Apache-2.0
 */

#ifndef ADV_H
#define ADV_H

#include "ble_common.h"

/* 在单个广播信道上发送 ADV_IND 并等待 CONNECT_IND
 * 返回: 1 = 收到有效 CONNECT_IND, 0 = 未收到 */
int adv_on_channel(uint32_t channel);

/* 在 37/38/39 三个信道上轮流广播
 * 返回: 1 = 连接建立, 0 = 本轮无连接 */
int adv_event(void);

#endif /* ADV_H */
```

## src/ble_common.h
```c
/*
 * BLE PHY CONNECT_IND Demo — 公共类型、常量与全局变量声明
 *
 * 本例程在 02_tifs_scan 基础上增加:
 *   - struct conn_param: CONNECT_IND 解析结果
 *   - RTC0 时间戳: 用于捕获 CONNECT_IND 接收时刻 (T0)
 *   - ADV 逻辑从 SCAN_REQ/SCAN_RSP 简化为只等待 CONNECT_IND
 *
 * SPDX-License-Identifier: Apache-2.0
 */

#ifndef BLE_COMMON_H
#define BLE_COMMON_H

#include <zephyr/kernel.h>
#include <zephyr/sys/printk.h>
#include <zephyr/sys/byteorder.h>
#include <string.h>
#include <soc.h>
#include <hal/nrf_clock.h>
#include <hal/nrf_timer.h>
#include <hal/nrf_ppi.h>

/* ---- Controller HAL 层头文件 ---- */
#include "hal/ccm.h"
#include "hal/radio.h"

/* ---- Controller PDU 结构体定义 ---- */
#include "pdu_df.h"
#include "pdu_vendor.h"
#include "pdu.h"

/* ---- Zephyr 控制器 Ticker 定时层 ---- */
#include "hal/ticker.h"

/*===========================================================================
 * 配置参数
 *===========================================================================*/

/* 广播间隔 (ms) */
#define ADV_INTERVAL_MS  100

/* T_IFS = 150 μs */
#define T_IFS_US         150

/* ADV RX 超时 (μs) */
#define ADV_RX_TIMEOUT_US  600

/* BLE 定时常量 */
#define CONN_INT_UNIT_US  1250  /* connInterval unit (1.25ms) */

#define ADV_NAME         "ConnInd"

/* TX/RX ramp-up 延迟 (μs): fast ramp-up ≈ 40 μs */
#define RX_RAMP_US       40
#define TX_RAMP_US       40

/*===========================================================================
 * PPI 通道分配 (SW TIFS)
 *===========================================================================*/
#define PPI_CH_TIMER_CLEAR  14   /* RADIO END → TIMER1 CLEAR */
#define PPI_CH_RXEN         15   /* TIMER1 CC[0] → RADIO RXEN */
#define PPI_CH_TXEN         16   /* TIMER1 CC[1] → RADIO TXEN */

#define CC_IDX_RXEN  0   /* Timer CC[0]: TX→RX 转换 */
#define CC_IDX_TXEN  1   /* Timer CC[1]: RX→TX 转换 */

/*===========================================================================
 * 连接参数结构体
 *===========================================================================*/
struct conn_param {
	uint8_t  access_addr[4];
	uint8_t  crc_init[3];
	uint8_t  win_size;
	uint16_t win_offset;
	uint16_t interval;
	uint16_t latency;
	uint16_t timeout;
	uint8_t  chan_map[PDU_CHANNEL_MAP_SIZE];
	uint8_t  hop;
	uint8_t  sca;
	uint8_t  chan_count;
	uint8_t  peer_addr[BDADDR_SIZE];
};

/*===========================================================================
 * 全局变量声明 (定义在 main.c)
 *===========================================================================*/

extern const uint8_t adv_addr[BDADDR_SIZE];
extern const uint8_t adv_data[];
#define ADV_DATA_LEN 14  /* sizeof(adv_data) */

extern struct conn_param conn_params;

/* PDU 缓冲区 */
extern struct pdu_adv pdu_adv_ind;
extern struct pdu_adv pdu_adv_rx;

/* CONNECT_IND 接收时刻 (NRF_RTC0 Counter) — 这就是 "T0", 锚点的起始基准 */
extern uint32_t connect_end_rtc;

/* SCA PPM 映射表 */
extern const uint16_t sca_ppm_table[];

/* 统计 */
extern volatile uint32_t adv_event_count;

#endif /* BLE_COMMON_H */
```

## src/hal_radio.c
```c
/*
 * BLE PHY CONNECT_IND Demo — HAL 层: 硬件初始化与 Radio 配置
 *
 * 相比 02_tifs_scan 的变化:
 *   - 新增 rtc0_start(): 启动 RTC0 为 CONNECT_IND 提供时间戳
 *   - radio_configure() 拆分为 radio_configure_adv() (后续例程还会加 conn)
 *
 * SPDX-License-Identifier: Apache-2.0
 */

#include "hal_radio.h"

/*===========================================================================
 * 启动 HFCLK
 *===========================================================================*/
void hfclk_start(void)
{
	NRF_CLOCK->EVENTS_HFCLKSTARTED = 0;
	NRF_CLOCK->TASKS_HFCLKSTART = 1;

	while (NRF_CLOCK->EVENTS_HFCLKSTARTED == 0) {
	}

	printk("HFCLK started\n");
}

/*===========================================================================
 * 启动 RTC0 — 提供 32768 Hz 时基
 *
 * CONNECT_IND 接收后, 我们需要立即读取 NRF_RTC0->COUNTER 得到 T0。
 * 这个 T0 是后续锚点计算的绝对基准 (04_phy_first_anchor 会使用它)。
 *
 * 在 Zephyr BLE Controller 中, 这由 ticker 子系统的 cntr_init() 完成。
 *===========================================================================*/
void rtc0_start(void)
{
	NRF_RTC0->TASKS_STOP = 1;
	NRF_RTC0->PRESCALER = 0;     /* 32768 Hz, 无分频 */
	NRF_RTC0->TASKS_CLEAR = 1;
	NRF_RTC0->TASKS_START = 1;

	printk("RTC0 started (32768 Hz)\n");
}

/*===========================================================================
 * 确保 Radio 回到 DISABLED 状态 (含 SW TIFS 清理)
 *===========================================================================*/
void radio_ensure_disabled(void)
{
	NRF_RADIO->SHORTS = 0;

	nrf_ppi_channels_disable(NRF_PPI, BIT(PPI_CH_RXEN) | BIT(PPI_CH_TXEN));

	nrf_timer_task_trigger(NRF_TIMER1, NRF_TIMER_TASK_STOP);

	if (NRF_RADIO->STATE != RADIO_STATE_STATE_Disabled) {
		NRF_RADIO->EVENTS_DISABLED = 0;
		NRF_RADIO->TASKS_DISABLE = 1;
		while (NRF_RADIO->EVENTS_DISABLED == 0) {
		}
	}
}

/*===========================================================================
 * 配置 Radio — 广播态
 *===========================================================================*/
void radio_configure_adv(void)
{
	NRF_RADIO->INTENCLR = 0xFFFFFFFFUL;
	NRF_RADIO->SHORTS = 0;

	radio_phy_set(0, 0);
	radio_tx_power_set(0);

	radio_pkt_configure(RADIO_PKT_CONF_LENGTH_8BIT,
			    PDU_AC_LEG_PAYLOAD_SIZE_MAX,
			    RADIO_PKT_CONF_FLAGS(
				    RADIO_PKT_CONF_PDU_TYPE_AC,
				    RADIO_PKT_CONF_PHY_LEGACY,
				    RADIO_PKT_CONF_CTE_DISABLED));

	uint32_t aa = sys_cpu_to_le32(PDU_AC_ACCESS_ADDR);
	radio_aa_set((const uint8_t *)&aa);
	radio_crc_configure(PDU_CRC_POLYNOMIAL, PDU_AC_CRC_IV);

	NRF_RADIO->TIFS = 0;

	printk("Radio configured: BLE 1M (ADV mode)\n");
}

/*===========================================================================
 * 配置 SW_SWITCH_TIMER (NRF_TIMER1)
 *===========================================================================*/
void sw_switch_timer_configure(void)
{
	nrf_timer_task_trigger(NRF_TIMER1, NRF_TIMER_TASK_STOP);
	nrf_timer_task_trigger(NRF_TIMER1, NRF_TIMER_TASK_CLEAR);

	NRF_TIMER1->INTENCLR = 0xFFFFFFFFUL;

	for (int i = 0; i < 6; i++) {
		NRF_TIMER1->EVENTS_COMPARE[i] = 0;
	}

	NRF_TIMER1->MODE      = TIMER_MODE_MODE_Timer;
	NRF_TIMER1->PRESCALER = 4;
	NRF_TIMER1->BITMODE   = TIMER_BITMODE_BITMODE_16Bit;

	printk("SW_SWITCH_TIMER (TIMER1) configured: 1MHz, 16-bit\n");
}

/*===========================================================================
 * 配置 PPI 通道
 *===========================================================================*/
void ppi_configure(void)
{
	nrf_ppi_channel_endpoint_setup(
		NRF_PPI,
		(nrf_ppi_channel_t)PPI_CH_TIMER_CLEAR,
		(uint32_t)&NRF_RADIO->EVENTS_END,
		(uint32_t)&NRF_TIMER1->TASKS_CLEAR);

	nrf_ppi_channel_endpoint_setup(
		NRF_PPI,
		(nrf_ppi_channel_t)PPI_CH_RXEN,
		(uint32_t)&NRF_TIMER1->EVENTS_COMPARE[CC_IDX_RXEN],
		(uint32_t)&NRF_RADIO->TASKS_RXEN);

	nrf_ppi_channel_endpoint_setup(
		NRF_PPI,
		(nrf_ppi_channel_t)PPI_CH_TXEN,
		(uint32_t)&NRF_TIMER1->EVENTS_COMPARE[CC_IDX_TXEN],
		(uint32_t)&NRF_RADIO->TASKS_TXEN);

	nrf_ppi_channels_enable(NRF_PPI, BIT(PPI_CH_TIMER_CLEAR));
	nrf_ppi_channels_disable(NRF_PPI, BIT(PPI_CH_RXEN) | BIT(PPI_CH_TXEN));

	printk("PPI configured: CH%d END→CLEAR, CH%d CC[%d]→RXEN, CH%d CC[%d]→TXEN\n",
	       PPI_CH_TIMER_CLEAR, PPI_CH_RXEN, CC_IDX_RXEN, PPI_CH_TXEN, CC_IDX_TXEN);
}
```

## src/hal_radio.h
```c
/*
 * BLE PHY CONNECT_IND Demo — HAL 层: 硬件初始化与 Radio 配置
 *
 * SPDX-License-Identifier: Apache-2.0
 */

#ifndef HAL_RADIO_INIT_H
#define HAL_RADIO_INIT_H

#include "ble_common.h"

/* 硬件初始化 */
void hfclk_start(void);
void rtc0_start(void);
void sw_switch_timer_configure(void);
void ppi_configure(void);

/* Radio 状态管理 */
void radio_ensure_disabled(void);
void radio_configure_adv(void);

#endif /* HAL_RADIO_INIT_H */
```

## src/ll_pdu.c
```c
/*
 * BLE PHY CONNECT_IND Demo — 链路层: PDU 构造与 CONNECT_IND 解析
 *
 * 相比 02_tifs_scan 的变化:
 *   - 移除 SCAN_REQ/SCAN_RSP 相关函数
 *   - 新增 validate_connect_ind(): 验证 CONNECT_IND 包类型、长度、AdvA
 *   - 新增 parse_connect_ind(): 提取 AA/CRC/Interval/Hop/SCA 等 12 个字段
 *   - 新增 print_connect_ind(): 格式化输出所有连接参数
 *   - 新增 count_ones(): 计算 Channel Map 中可用信道数
 *
 * SPDX-License-Identifier: Apache-2.0
 */

#include "ll_pdu.h"

/*===========================================================================
 * 辅助函数: 统计比特数
 *===========================================================================*/
uint8_t count_ones(const uint8_t *data, uint8_t len)
{
	uint8_t count = 0;

	for (uint8_t i = 0; i < len; i++) {
		uint8_t byte = data[i];

		while (byte) {
			count += byte & 1;
			byte >>= 1;
		}
	}
	return count;
}

/*===========================================================================
 * 构造 ADV_IND PDU
 *===========================================================================*/
void build_adv_ind_pdu(void)
{
	memset(&pdu_adv_ind, 0, sizeof(pdu_adv_ind));

	pdu_adv_ind.type    = PDU_ADV_TYPE_ADV_IND;
	pdu_adv_ind.tx_addr = 1;
	pdu_adv_ind.chan_sel = 0;
	pdu_adv_ind.rx_addr = 0;
	pdu_adv_ind.len     = BDADDR_SIZE + ADV_DATA_LEN;

	memcpy(pdu_adv_ind.adv_ind.addr, adv_addr, BDADDR_SIZE);
	memcpy(pdu_adv_ind.adv_ind.data, adv_data, ADV_DATA_LEN);
}

/*===========================================================================
 * 验证 CONNECT_IND
 *
 * 检查三个条件:
 *   1. PDU 类型是否为 CONNECT_IND
 *   2. 长度是否匹配 (34 字节: InitA(6) + AdvA(6) + LLData(22))
 *   3. AdvA 是否指向我们的地址 (确保不是给别的广播者的)
 *===========================================================================*/
bool validate_connect_ind(const struct pdu_adv *rx_pdu)
{
	if (rx_pdu->type != PDU_ADV_TYPE_CONNECT_IND) {
		return false;
	}
	if (rx_pdu->len != sizeof(struct pdu_adv_connect_ind)) {
		return false;
	}
	if (memcmp(rx_pdu->connect_ind.adv_addr, adv_addr, BDADDR_SIZE) != 0) {
		return false;
	}
	return true;
}

/*===========================================================================
 * 解析 CONNECT_IND — 提取 LLData 中的 12 个连接参数字段
 *
 * CONNECT_IND 的 LLData 布局 (BLE Core Spec Vol 6, Part B, 2.3.3.1):
 *
 *   Offset  Size  Field
 *   ──────  ────  ─────────────
 *   0       4     AA (Access Address)
 *   4       3     CRCInit
 *   7       1     WinSize
 *   8       2     WinOffset
 *   10      2     Interval
 *   12      2     Latency
 *   14      2     Timeout
 *   16      5     ChM (Channel Map)
 *   21      1     Hop (5 bits) + SCA (3 bits)
 *
 * 我们利用 Zephyr 的 struct pdu_adv_connect_ind 结构体映射这些字段,
 * 避免手工按字节偏移解析。
 *===========================================================================*/
void parse_connect_ind(const struct pdu_adv *rx_pdu)
{
	const struct pdu_adv_connect_ind *ci = &rx_pdu->connect_ind;

	memcpy(conn_params.peer_addr, ci->init_addr, BDADDR_SIZE);
	memcpy(conn_params.access_addr, ci->access_addr, 4);
	memcpy(conn_params.crc_init, ci->crc_init, 3);

	conn_params.win_size   = ci->win_size;
	conn_params.win_offset = sys_le16_to_cpu(ci->win_offset);
	conn_params.interval   = sys_le16_to_cpu(ci->interval);
	conn_params.latency    = sys_le16_to_cpu(ci->latency);
	conn_params.timeout    = sys_le16_to_cpu(ci->timeout);

	memcpy(conn_params.chan_map, ci->chan_map, PDU_CHANNEL_MAP_SIZE);
	conn_params.hop = ci->hop;
	conn_params.sca = ci->sca;
	conn_params.chan_count = count_ones(conn_params.chan_map,
					    PDU_CHANNEL_MAP_SIZE);
}

/*===========================================================================
 * 打印 CONNECT_IND 参数
 *
 * 格式化输出所有解析结果, 方便验证连接请求是否正确接收。
 * 每个字段同时打印原始值和换算后的物理量。
 *===========================================================================*/
void print_connect_ind(void)
{
	uint32_t aa_val = sys_get_le32(conn_params.access_addr);
	uint32_t crc_val = conn_params.crc_init[0] |
			   ((uint32_t)conn_params.crc_init[1] << 8) |
			   ((uint32_t)conn_params.crc_init[2] << 16);

	printk("\n========== CONNECT_IND Received ==========\n");
	printk("  Peer:       %02X:%02X:%02X:%02X:%02X:%02X\n",
	       conn_params.peer_addr[5], conn_params.peer_addr[4],
	       conn_params.peer_addr[3], conn_params.peer_addr[2],
	       conn_params.peer_addr[1], conn_params.peer_addr[0]);
	printk("  AA:         0x%08X\n", aa_val);
	printk("  CRC Init:   0x%06X\n", crc_val);
	printk("  WinSize:    %d (x1.25ms = %d us)\n",
	       conn_params.win_size,
	       (uint32_t)conn_params.win_size * CONN_INT_UNIT_US);
	printk("  WinOffset:  %d (x1.25ms = %d us)\n",
	       conn_params.win_offset,
	       (uint32_t)conn_params.win_offset * CONN_INT_UNIT_US);
	printk("  Interval:   %d (x1.25ms = %d us)\n",
	       conn_params.interval,
	       (uint32_t)conn_params.interval * CONN_INT_UNIT_US);
	printk("  Latency:    %d\n", conn_params.latency);
	printk("  Timeout:    %d (x10ms = %d ms)\n", conn_params.timeout,
	       (uint32_t)conn_params.timeout * 10);
	printk("  Hop:        %d\n", conn_params.hop);
	printk("  SCA:        %d (%d ppm)\n", conn_params.sca,
	       sca_ppm_table[conn_params.sca & 0x07]);
	printk("  Chan Count: %d / 37\n", conn_params.chan_count);
	printk("  T0 (RTC0):  %u ticks\n", connect_end_rtc);
	printk("==========================================\n");
}
```

## src/ll_pdu.h
```c
/*
 * BLE PHY CONNECT_IND Demo — 链路层 PDU 构造与校验
 *
 * SPDX-License-Identifier: Apache-2.0
 */

#ifndef LL_PDU_H
#define LL_PDU_H

#include "ble_common.h"

/* 辅助函数 */
uint8_t count_ones(const uint8_t *data, uint8_t len);

/* ADV PDU */
void build_adv_ind_pdu(void);

/* CONNECT_IND */
bool validate_connect_ind(const struct pdu_adv *rx_pdu);
void parse_connect_ind(const struct pdu_adv *rx_pdu);
void print_connect_ind(void);

#endif /* LL_PDU_H */
```
