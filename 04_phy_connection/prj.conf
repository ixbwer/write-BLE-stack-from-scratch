## CMakeLists.txt
```
# SPDX-License-Identifier: Apache-2.0

cmake_minimum_required(VERSION 3.20.0)
find_package(Zephyr REQUIRED HINTS $ENV{ZEPHYR_BASE})
project(ble_phy_connection)

target_sources(app PRIVATE
  src/main.c
  ../stack/hal_radio.c
  ../stack/adv.c
  ../stack/conn.c
  ../stack/conn_event.c
  ../stack/anchor.c
  ../stack/ll_pdu.c
  ../stack/compat_globals.c
)


# Add BLE controller internal include paths so we can use HAL APIs and PDU structs
target_compile_definitions(app PRIVATE
  BLE_FEATURE_MULTI_PDU=0
  BLE_FEATURE_ATT=0
  BLE_FEATURE_SMP=0
  BLE_FEATURE_SLAVE_CPR=0
  BLE_FEATURE_SLAVE_TERMINATE=0
  BLE_FEATURE_GATT_NOTIFY=0
  BLE_FEATURE_SLAVE_LATENCY=0
  BLE_FEATURE_LL_PROCEDURE=0
)

target_include_directories(app PRIVATE
  ${CMAKE_CURRENT_SOURCE_DIR}/src
  ${CMAKE_CURRENT_SOURCE_DIR}/../stack
  ${ZEPHYR_BASE}/subsys/bluetooth/controller
  # controller/include — resolves "ll.h" etc.
  ${ZEPHYR_BASE}/subsys/bluetooth/controller/include
  # Nordic vendor — resolves "hal/radio_vendor_hal.h" -> "hal/nrf5/radio/radio.h"
  ${ZEPHYR_BASE}/subsys/bluetooth/controller/ll_sw/nordic
  # ll_sw — resolves "pdu.h", "pdu_df.h"
  ${ZEPHYR_BASE}/subsys/bluetooth/controller/ll_sw
  # Nordic LLL — resolves "pdu_vendor.h"
  ${ZEPHYR_BASE}/subsys/bluetooth/controller/ll_sw/nordic/lll
  ${ZEPHYR_BASE}/subsys/bluetooth/controller/ll_sw/nordic/hal/nrf5/nrfx_glue
  ${ZEPHYR_BASE}/subsys/bluetooth
)
```

## prj.conf
```kconfig
# BLE PHY Connection Demo
# 多事件连接循环 (锚点递推、跳频、SN/NESN 流控、supervision timeout)

CONFIG_GPIO=y
CONFIG_SERIAL=y
CONFIG_CONSOLE=y
CONFIG_UART_CONSOLE=y
CONFIG_PRINTK=y

# 启用 BLE Controller (Split Link Layer) — 编译 HAL 代码
CONFIG_BT=y
CONFIG_BT_LL_SW_SPLIT=y
CONFIG_BT_BROADCASTER=y
CONFIG_BT_PERIPHERAL=y

# 不需要 Host 层功能
CONFIG_BT_OBSERVER=n
CONFIG_BT_CENTRAL=n
```

## src/main.c
```c
/*
 * BLE PHY Connection Demo
 *
 * Multi-event connection loop: anchor progression, channel hopping,
 * SN/NESN flow control, and supervision timeout
 *
 * SPDX-License-Identifier: Apache-2.0
 */

#include "ble_common.h"
#include "hal_radio.h"
#include "ll_pdu.h"
#include "adv.h"
#include "conn.h"
#include "hci.h"

/*===========================================================================
 * Global definitions (demo-specific override)
 *
 * Shared globals (conn_params, pdu buffers, anchor, counters, ...) use the
 * weak default definitions in stack/compat_globals.c — do NOT re-define them
 * here, the struct layouts live in stack/ble_common.h.
 *===========================================================================*/

/* Advertising name = "ConLoop" (overrides the weak default from compat_globals) */
uint8_t adv_data[ADV_DATA_LEN_MAX] = {
	0x02, 0x01, 0x06,
	0x08, 0x09, 'C', 'o', 'n', 'L', 'o', 'o', 'p'
};
uint8_t adv_data_len = 12;

/*===========================================================================
 * Main entry
 *===========================================================================*/
int main(void)
{
	printk("\n");
	printk("===================================================\n");
	printk("  BLE PHY Connection Loop Demo\n");
	printk("  多事件连接循环: 跳频, SN/NESN, 键点递推\n");
	printk("===================================================\n");
	printk("Device: %s  Addr: %02X:%02X:%02X:%02X:%02X:%02X\n",
	       ADV_NAME,
	       adv_addr[5], adv_addr[4], adv_addr[3],
	       adv_addr[2], adv_addr[1], adv_addr[0]);
	printk("\n");

	hfclk_start();
	rtc0_start();
	sw_switch_timer_configure();
	ppi_configure();
	h4_init();

	while (1) {
		printk("[STATE] Entering ADVERTISING state\n");
		adv_event_count = 0;

		radio_configure_adv();
		build_adv_ind_pdu();

		bool connected = false;

		while (!connected) {
			int ret = adv_event();

			if (ret == 1) {
				connected = true;
			} else {
				k_msleep(ADV_INTERVAL_MS);
			}
		}

		/* Received CONNECT_IND - enter the connection state. */
		conn_loop();
		printk("[STATE] Connection ended, returning to advertising...\n\n");
		radio_ensure_disabled();
		k_msleep(100);
	}

	return 0;
}
```
