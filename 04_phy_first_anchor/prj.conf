## CMakeLists.txt
```
# SPDX-License-Identifier: Apache-2.0

cmake_minimum_required(VERSION 3.20.0)
find_package(Zephyr REQUIRED HINTS $ENV{ZEPHYR_BASE})
project(ble_phy_first_anchor)

target_sources(app PRIVATE
  src/main.c
  src/hal_radio.c
  src/ll_pdu.c
  src/adv.c
  src/conn.c
)

# Add BLE controller internal include paths so we can use HAL APIs and PDU structs
target_include_directories(app PRIVATE
  # controller root — resolves "hal/radio.h" -> controller/hal/radio.h (redirect)
  ${ZEPHYR_BASE}/subsys/bluetooth/controller
  # controller/include — resolves "ll.h" etc.
  ${ZEPHYR_BASE}/subsys/bluetooth/controller/include
  # Nordic vendor — resolves "hal/radio_vendor_hal.h" -> "hal/nrf5/radio/radio.h"
  ${ZEPHYR_BASE}/subsys/bluetooth/controller/ll_sw/nordic
  # ll_sw — resolves "pdu.h", "pdu_df.h"
  ${ZEPHYR_BASE}/subsys/bluetooth/controller/ll_sw
  # Nordic LLL — resolves "pdu_vendor.h"
  ${ZEPHYR_BASE}/subsys/bluetooth/controller/ll_sw/nordic/lll
)
```

## prj.conf
```kconfig
# BLE PHY First Anchor Demo
# 首次锚点计算与硬件调度链: RTC0 → TIMER0 → PPI → Radio RXEN

CONFIG_GPIO=y
CONFIG_SERIAL=y
CONFIG_CONSOLE=y
CONFIG_UART_CONSOLE=y
CONFIG_PRINTK=y

# 启用 BLE Controller (Split Link Layer) — 编译 HAL 代码
CONFIG_BT=y
CONFIG_BT_LL_SW_SPLIT=y
CONFIG_BT_BROADCASTER=y
CONFIG_BT_PERIPHERAL=y

# 不需要 Host 层功能
CONFIG_BT_OBSERVER=n
CONFIG_BT_CENTRAL=n
```

## src/main.c
```c
/*
 * BLE PHY First Anchor (首次锚点) Demo
 *
 * 本 Demo 在 03_phy_connect_ind 基础上, 实现了:
 *   1. 从 CONNECT_IND 参数计算首次锚点 A0
 *   2. 通过 RTC0→TIMER0→PPI→RXEN 硬件链在精确时刻启动 RX
 *   3. 执行一个连接事件 (RX Master 数据包 + TX 空 PDU)
 *   4. 打印锚点计算 6 步详细过程
 *
 * 锚点公式:
 *
 *   A0 = T0 + winOffset × 1.25ms + transmitWindowDelay(1.25ms) - margins
 *
 *   其中 margins = TICKER_RES_MARGIN + JITTER + rx_ready_delay + ww_periodic
 *   (提前开 RX, 宁早勿迟)
 *
 * 硬件调度链 (零 CPU 延迟):
 *
 *   NRF_RTC0 ──CC[2]match──> PPI ──> NRF_TIMER0 START
 *   NRF_TIMER0 ──CC[0]=remainder──> PPI ──> RADIO RXEN
 *   RADIO RXEN → 40μs ramp-up → RX START
 *
 * 代码结构:
 *   ble_common.h  — 公共类型 (新增 anchor_tracker, 锚点常量)
 *   hal_radio.c/h — HAL 层 (新增 radio_configure_conn, data_chan_set)
 *   ll_pdu.c/h    — PDU (新增 build_empty_pdu, chan_sel_1, print_anchor_calculation)
 *   adv.c/h       — 广播态 (同 03)
 *   conn.c/h      — 连接态 (新增! conn_first_event: 锚点计算 + 单次事件)
 *   main.c        — 主状态机
 *
 * SPDX-License-Identifier: Apache-2.0
 */

#include "ble_common.h"
#include "hal_radio.h"
#include "ll_pdu.h"
#include "adv.h"
#include "conn.h"

/*===========================================================================
 * 全局变量定义
 *===========================================================================*/

const uint8_t adv_addr[BDADDR_SIZE] = {
	0x11, 0x22, 0x33, 0x44, 0x55, 0x66
};

const uint8_t adv_data[] = {
	0x02, 0x01, 0x06,
	0x08, 0x09, '1', 's', 't', 'A', 'n', 'c', 'h'
};

struct conn_param conn_params;

/* 连接态变量 */
uint8_t tx_sn;
uint8_t rx_nesn;
uint16_t conn_event_counter;
uint8_t last_unmapped_chan;

struct pdu_data tx_pdu_buf __aligned(4);

/* PDU 缓冲区 */
struct pdu_adv pdu_adv_ind __aligned(4);
struct pdu_adv pdu_adv_rx __aligned(4);
struct pdu_data pdu_data_rx __aligned(4);

/* CONNECT_IND 接收时刻 */
uint32_t connect_end_rtc;

/* SCA PPM 映射表 */
const uint16_t sca_ppm_table[] = {500, 250, 150, 100, 75, 50, 30, 20};

/* 锚点追踪 */
struct anchor_tracker anchor;

/* 统计 */
volatile uint32_t adv_event_count;
volatile uint32_t conn_event_rx_ok;
volatile uint32_t conn_event_rx_timeout;

/*===========================================================================
 * 主函数
 *===========================================================================*/
int main(void)
{
	printk("\n");
	printk("===================================================\n");
	printk("  BLE PHY First Anchor Demo\n");
	printk("  计算首次锚点 A0 并执行一个连接事件\n");
	printk("===================================================\n");
	printk("Device: %s  Addr: %02X:%02X:%02X:%02X:%02X:%02X\n",
	       ADV_NAME,
	       adv_addr[5], adv_addr[4], adv_addr[3],
	       adv_addr[2], adv_addr[1], adv_addr[0]);
	printk("\n");

	hfclk_start();
	rtc0_start();
	sw_switch_timer_configure();
	ppi_configure();

	while (1) {
		printk("[STATE] Entering ADVERTISING state\n");
		adv_event_count = 0;

		radio_configure_adv();
		build_adv_ind_pdu();

		bool connected = false;

		while (!connected) {
			int ret = adv_event();

			if (ret == 1) {
				connected = true;
			} else {
				k_msleep(ADV_INTERVAL_MS);
			}
		}

		/* ★ 收到 CONNECT_IND! 执行首次连接事件 */
		conn_first_event();

		printk("[STATE] First event done, returning to advertising...\n\n");
		radio_ensure_disabled();
		k_msleep(100);
	}

	return 0;
}
```

## src/adv.c
```c
/*
 * BLE PHY First Anchor Demo — 广播态: ADV_IND 发送与 CONNECT_IND 接收
 *
 * (与 03_phy_connect_ind 的 adv.c 相同)
 *
 * SPDX-License-Identifier: Apache-2.0
 */

#include "adv.h"
#include "hal_radio.h"
#include "ll_pdu.h"

/*===========================================================================
 * 广播信道处理
 *===========================================================================*/
int adv_on_channel(uint32_t channel)
{
	uint32_t freq;

	switch (channel) {
	case 37: freq = 2;  break;
	case 38: freq = 26; break;
	case 39: freq = 80; break;
	default: return 0;
	}

	radio_freq_chan_set(freq);
	radio_whiten_iv_set(channel);

	NRF_RADIO->INTENCLR = 0xFFFFFFFFUL;

	/*==============================================================
	 * 第 1 阶段: TX ADV_IND (SW TIFS)
	 *==============================================================*/

	radio_pkt_tx_set(&pdu_adv_ind);

	radio_status_reset();
	NRF_RADIO->EVENTS_DISABLED = 0;
	NRF_RADIO->EVENTS_END = 0;
	NRF_RADIO->EVENTS_ADDRESS = 0;

	NRF_RADIO->SHORTS = RADIO_SHORTS_READY_START_Msk |
			    RADIO_SHORTS_END_DISABLE_Msk;

	nrf_timer_cc_set(NRF_TIMER1, (nrf_timer_cc_channel_t)CC_IDX_RXEN,
			 T_IFS_US - RX_RAMP_US);
	nrf_ppi_channels_disable(NRF_PPI, BIT(PPI_CH_RXEN) | BIT(PPI_CH_TXEN));

	nrf_timer_task_trigger(NRF_TIMER1, NRF_TIMER_TASK_CLEAR);
	nrf_timer_task_trigger(NRF_TIMER1, NRF_TIMER_TASK_START);

	NRF_RADIO->TASKS_TXEN = 1;

	while (NRF_RADIO->EVENTS_END == 0) {
	}
	NRF_RADIO->EVENTS_END = 0;

	/*==============================================================
	 * TX→RX 转换 (SW TIFS)
	 *==============================================================*/

	NRF_TIMER1->EVENTS_COMPARE[CC_IDX_RXEN] = 0;
	(void)NRF_TIMER1->EVENTS_COMPARE[CC_IDX_RXEN];

	radio_pkt_rx_set(&pdu_adv_rx);

	nrf_ppi_channels_enable(NRF_PPI, BIT(PPI_CH_RXEN));

	while (NRF_RADIO->EVENTS_DISABLED == 0) {
	}
	NRF_RADIO->EVENTS_DISABLED = 0;

	/*==============================================================
	 * 第 2 阶段: RX 等待 CONNECT_IND
	 *==============================================================*/

	NRF_RADIO->EVENTS_ADDRESS = 0;

	uint32_t timeout_loops = ADV_RX_TIMEOUT_US * 16;
	bool rx_done = false;

	while (timeout_loops > 0) {
		if (NRF_RADIO->EVENTS_DISABLED) {
			rx_done = true;
			break;
		}
		timeout_loops--;
	}

	/* ★ 立即捕获 T0 */
	uint32_t rx_end_rtc = NRF_RTC0->COUNTER & HAL_TICKER_CNTR_MASK;

	if (!rx_done) {
		radio_ensure_disabled();
		return 0;
	}

	nrf_ppi_channels_disable(NRF_PPI, BIT(PPI_CH_RXEN));
	NRF_RADIO->SHORTS = 0;

	if (!radio_crc_is_valid()) {
		return 0;
	}

	if (validate_connect_ind(&pdu_adv_rx)) {
		connect_end_rtc = rx_end_rtc;
		parse_connect_ind(&pdu_adv_rx);
		return 1;
	}

	return 0;
}

/*===========================================================================
 * 广播事件
 *===========================================================================*/
int adv_event(void)
{
	static const uint32_t adv_channels[] = {37, 38, 39};

	for (int i = 0; i < 3; i++) {
		int ret = adv_on_channel(adv_channels[i]);

		if (ret == 1) {
			return 1;
		}
	}

	adv_event_count++;
	if (adv_event_count <= 3 || adv_event_count % 50 == 0) {
		printk("[ADV] events: %u (waiting for connection...)\n",
		       adv_event_count);
	}
	return 0;
}
```

## src/adv.h
```c
/*
 * BLE PHY First Anchor Demo — 广播态
 *
 * SPDX-License-Identifier: Apache-2.0
 */

#ifndef ADV_H
#define ADV_H

#include "ble_common.h"

int adv_on_channel(uint32_t channel);
int adv_event(void);

#endif /* ADV_H */
```

## src/ble_common.h
```c
/*
 * BLE PHY First Anchor Demo — 公共类型、常量与全局变量声明
 *
 * 相比 03_phy_connect_ind 新增:
 *   - struct anchor_tracker: 锚点追踪
 *   - 锚点计算相关常量 (WIN_DELAY, EVENT_JITTER, ...)
 *   - 连接态变量 (tx_sn, rx_nesn, conn_event_counter, ...)
 *   - 数据 PDU 缓冲区
 *
 * SPDX-License-Identifier: Apache-2.0
 */

#ifndef BLE_COMMON_H
#define BLE_COMMON_H

#include <zephyr/kernel.h>
#include <zephyr/sys/printk.h>
#include <zephyr/sys/byteorder.h>
#include <string.h>
#include <soc.h>
#include <hal/nrf_clock.h>
#include <hal/nrf_timer.h>
#include <hal/nrf_ppi.h>

/* ---- Controller HAL 层头文件 ---- */
#include "hal/ccm.h"
#include "hal/radio.h"

/* ---- Controller PDU 结构体定义 ---- */
#include "pdu_df.h"
#include "pdu_vendor.h"
#include "pdu.h"

/* ---- Zephyr 控制器 Ticker 定时层 ---- */
#include "hal/ticker.h"

/*===========================================================================
 * 配置参数
 *===========================================================================*/

/* 广播间隔 (ms) */
#define ADV_INTERVAL_MS  100

/* T_IFS = 150 μs */
#define T_IFS_US         150

/* ADV RX 超时 (μs) */
#define ADV_RX_TIMEOUT_US  600

/* BLE 定时常量 */
#define WIN_DELAY_LEGACY            1250  /* transmitWindowDelay (μs) */
#define CONN_INT_UNIT_US            1250  /* connInterval unit (1.25ms) */
#define EVENT_JITTER_US             16    /* Active clock jitter margin (μs) */
#define EVENT_TICKER_RES_MARGIN_US  31    /* RTC tick resolution ~30.52μs ceil */
#define ADDR_US_1M                  40    /* Preamble(8)+AA(32) for 1M PHY */
#define RTC0_CMP_OFFSET_MIN         3     /* NRF_RTC0 CC 最小比较偏移 */

#define ADV_NAME         "1stAnch"

/* TX/RX ramp-up 延迟 (μs): fast ramp-up ≈ 40 μs */
#define RX_RAMP_US       40
#define TX_RAMP_US       40

/* Chain delay: RADIO END 事件相对于实际空中包结束的延迟
 * nRF52832 1M PHY: RX chain delay = 9.4μs (ceil→10), TX chain delay = 0.6μs (ceil→1) */
#define RX_CHAIN_DELAY_1M_US  10
#define TX_CHAIN_DELAY_US      1

/*===========================================================================
 * PPI 通道分配 (SW TIFS)
 *===========================================================================*/
#define PPI_CH_TIMER_CLEAR  14   /* RADIO END → TIMER1 CLEAR */
#define PPI_CH_RXEN         15   /* TIMER1 CC[0] → RADIO RXEN */
#define PPI_CH_TXEN         16   /* TIMER1 CC[1] → RADIO TXEN */

#define CC_IDX_RXEN  0   /* Timer CC[0]: TX→RX 转换 */
#define CC_IDX_TXEN  1   /* Timer CC[1]: RX→TX 转换 */

#define LOCAL_SCA_PPM 50

/*===========================================================================
 * 连接参数结构体
 *===========================================================================*/
struct conn_param {
	uint8_t  access_addr[4];
	uint8_t  crc_init[3];
	uint8_t  win_size;
	uint16_t win_offset;
	uint16_t interval;
	uint16_t latency;
	uint16_t timeout;
	uint8_t  chan_map[PDU_CHANNEL_MAP_SIZE];
	uint8_t  hop;
	uint8_t  sca;
	uint8_t  chan_count;
	uint8_t  peer_addr[BDADDR_SIZE];
};

/*===========================================================================
 * 锚点追踪结构体
 *===========================================================================*/
struct anchor_tracker {
	uint32_t initial_anchor_rtc;     /* 首次计算出的锚点 RTC tick */
	uint32_t initial_anchor_us;      /* 首次锚点的 μs 偏移量 */
	uint32_t current_anchor_rtc;     /* 当前锚点 RTC tick */
};

/*===========================================================================
 * 全局变量声明 (定义在 main.c)
 *===========================================================================*/

extern const uint8_t adv_addr[BDADDR_SIZE];
extern const uint8_t adv_data[];
#define ADV_DATA_LEN 14  /* sizeof(adv_data) */

extern struct conn_param conn_params;

/* 连接态变量 */
extern uint8_t tx_sn;
extern uint8_t rx_nesn;
extern uint16_t conn_event_counter;
extern uint8_t last_unmapped_chan;

extern struct pdu_data tx_pdu_buf;

/* PDU 缓冲区 */
extern struct pdu_adv pdu_adv_ind;
extern struct pdu_adv pdu_adv_rx;
extern struct pdu_data pdu_data_rx;

/* CONNECT_IND 接收时刻 */
extern uint32_t connect_end_rtc;

/* SCA PPM 映射表 */
extern const uint16_t sca_ppm_table[];

/* 锚点追踪 */
extern struct anchor_tracker anchor;

/* 统计 */
extern volatile uint32_t adv_event_count;
extern volatile uint32_t conn_event_rx_ok;
extern volatile uint32_t conn_event_rx_timeout;

#endif /* BLE_COMMON_H */
```

## src/conn.c
```c
/*
 * BLE PHY First Anchor Demo — 连接态: 首次连接事件
 *
 * 本文件实现了锚点计算和单个连接事件的执行:
 *
 * ★ conn_first_event() 的流程:
 *   1. 从 CONNECT_IND 参数计算首次锚点 A0
 *   2. 用 chan_sel_1() 计算第一个数据信道
 *   3. 用 radio_tmr_start() 配置 RTC0→TIMER0→PPI→RXEN 硬件链
 *   4. 执行一个 RX→TX 连接事件
 *   5. 打印详细的锚点计算过程
 *
 * ★ 硬件定时链 (零 CPU 延迟):
 *
 *   RTC0 CC[2] match ──PPI──> TIMER0 START
 *   TIMER0 CC[0]=remainder ──PPI──> RADIO RXEN
 *   RADIO RXEN → 40μs ramp → RX START
 *
 *   这条链让 Radio 在精确的锚点时刻开始 RX,
 *   无需 CPU 参与, 消除了中断延迟和任务调度抖动。
 *
 * SPDX-License-Identifier: Apache-2.0
 */

#include "conn.h"
#include "hal_radio.h"
#include "ll_pdu.h"

/*===========================================================================
 * 单个连接事件
 *
 * 与 06_phy_anchor 的 conn_event() 相同, 但不处理 LL Control PDU。
 *===========================================================================*/
static bool conn_event(uint32_t ticks_at_start, uint32_t remainder_ps,
		       uint32_t hcto_add)
{
	/* 检查目标 RTC tick 是否在未来 */
	uint32_t ahead = (ticks_at_start - NRF_RTC0->COUNTER) &
			 HAL_TICKER_CNTR_MASK;
	if (ahead > (HAL_TICKER_CNTR_MASK >> 1) ||
	    ahead < RTC0_CMP_OFFSET_MIN) {
		(void)chan_sel_1();
		conn_event_rx_timeout++;
		conn_event_counter++;
		return false;
	}

	uint8_t chan = chan_sel_1();
	data_chan_set(chan);

	NRF_RADIO->INTENCLR = 0xFFFFFFFFUL;
	radio_status_reset();

	/* 清理上一个事件遗留的 HAL PPI/Timer 状态 */
	radio_tmr_status_reset();

	NRF_RADIO->SHORTS = RADIO_SHORTS_READY_START_Msk |
			    RADIO_SHORTS_END_DISABLE_Msk;

	nrf_ppi_channels_disable(NRF_PPI, BIT(PPI_CH_RXEN) | BIT(PPI_CH_TXEN));

	/* 设置 Timer1 CC[1] for RX→TX 转换 */
	nrf_timer_cc_set(NRF_TIMER1, (nrf_timer_cc_channel_t)CC_IDX_TXEN,
			 T_IFS_US - TX_RAMP_US - RX_CHAIN_DELAY_1M_US);

	nrf_timer_task_trigger(NRF_TIMER1, NRF_TIMER_TASK_CLEAR);
	nrf_timer_task_trigger(NRF_TIMER1, NRF_TIMER_TASK_START);

	radio_pkt_rx_set(&pdu_data_rx);

	/* 停止 TIMER0 + 清除 RTC0 比较事件 (防止遗留干扰) */
	nrf_timer_task_trigger(NRF_TIMER0, NRF_TIMER_TASK_STOP);
	NRF_RTC0->EVENTS_COMPARE[2] = 0;

	/* ★ 传锚点给硬件: radio_tmr_start 配置 RTC0→TIMER0→PPI→RXEN */
	uint32_t remainder_us = radio_tmr_start(0, ticks_at_start,
						remainder_ps);

	radio_tmr_aa_capture();
	radio_tmr_aa_save(0);

	/* HCTO: 如果在锚点 + HCTO 时间内没收到包头, 自动 DISABLE Radio */
	uint32_t hcto = remainder_us + hcto_add +
			radio_rx_ready_delay_get(0, 0) +
			ADDR_US_1M +
			radio_rx_chain_delay_get(0, 0);
	radio_tmr_hcto_configure(hcto);

	radio_tmr_end_capture();

	/* 等待 RX 完成或 HCTO 超时 */
	{
		uint32_t safety = 0;

		while (NRF_RADIO->EVENTS_DISABLED == 0) {
			if (++safety > 5000000) {
				printk("!STUCK RX! ST=%u\n", NRF_RADIO->STATE);
				NRF_RADIO->TASKS_DISABLE = 1;
				while (NRF_RADIO->EVENTS_DISABLED == 0) {
				}
				conn_event_rx_timeout++;
				conn_event_counter++;
				return false;
			}
		}
	}
	NRF_RADIO->EVENTS_DISABLED = 0;

	if (!radio_is_done()) {
		radio_ensure_disabled();
		conn_event_rx_timeout++;
		conn_event_counter++;
		return false;
	}

	if (!radio_crc_is_valid()) {
		radio_ensure_disabled();
		conn_event_rx_timeout++;
		conn_event_counter++;
		return false;
	}

	conn_event_rx_ok++;

	/*==============================================================
	 * SW TIFS: RX→TX 转换
	 *==============================================================*/

	NRF_TIMER1->EVENTS_COMPARE[CC_IDX_TXEN] = 0;
	(void)NRF_TIMER1->EVENTS_COMPARE[CC_IDX_TXEN];
	NRF_TIMER1->EVENTS_COMPARE[CC_IDX_RXEN] = 0;
	(void)NRF_TIMER1->EVENTS_COMPARE[CC_IDX_RXEN];

	/* 准备 TX: 空 PDU */
	build_empty_pdu(&tx_pdu_buf);
	radio_pkt_tx_set(&tx_pdu_buf);

	/* 启用 PPI_CH_TXEN */
	nrf_ppi_channels_enable(NRF_PPI, BIT(PPI_CH_TXEN));

	NRF_RADIO->EVENTS_END = 0;
	NRF_RADIO->EVENTS_DISABLED = 0;

	/* 等待 TX 完成 */
	{
		uint32_t safety = 0;

		while (NRF_RADIO->EVENTS_DISABLED == 0) {
			if (++safety > 2000000) {
				printk("!STUCK TX! ST=%u\n", NRF_RADIO->STATE);
				NRF_RADIO->TASKS_DISABLE = 1;
				while (NRF_RADIO->EVENTS_DISABLED == 0) {
				}
				break;
			}
		}
	}

	NRF_RADIO->EVENTS_DISABLED = 0;

	nrf_ppi_channels_disable(NRF_PPI, BIT(PPI_CH_TXEN));
	NRF_RADIO->SHORTS = 0;

	printk("[CONN] #%u ch=%u RX OK, TX empty PDU sent\n",
	       conn_event_counter, chan);

	conn_event_counter++;
	return true;
}

/*===========================================================================
 * 首次连接事件 — 锚点计算 + 单次 RX/TX
 *
 * ★ 这是本 Demo 的核心: 展示锚点如何从 CONNECT_IND 参数计算出来
 *
 * 公式 (BLE Core Spec Vol 6, Part B, 4.5.1):
 *   A0 = T0 + transmitWindowOffset + transmitWindowDelay
 *
 * 工程实现加了提前量 (margin):
 *   conn_offset_us = winOffset×1250 + 1250 - margins
 *
 * 减去 margins 是为了让 Radio 提前开 RX, 宁可早到也不能迟到
 *===========================================================================*/
void conn_first_event(void)
{
	/* 初始化连接状态 */
	tx_sn = 0;
	rx_nesn = 0;
	conn_event_counter = 0;
	last_unmapped_chan = 0;
	conn_event_rx_ok = 0;
	conn_event_rx_timeout = 0;

	memset(&anchor, 0, sizeof(anchor));

	radio_configure_conn();

	/* ==== 连接参数计算 ==== */
	uint32_t conn_interval_us = (uint32_t)conn_params.interval * CONN_INT_UNIT_US;
	uint32_t win_size_us = (uint32_t)conn_params.win_size * CONN_INT_UNIT_US;

	/* Window Widening 参数 (仅用于计算, 本例程不动态累积) */
	uint16_t master_sca_ppm = sca_ppm_table[conn_params.sca & 0x07];
	uint32_t combined_sca_ppm = (uint32_t)master_sca_ppm + LOCAL_SCA_PPM;
	uint32_t ww_periodic_us = DIV_ROUND_UP(
		combined_sca_ppm * conn_interval_us, 1000000);

	/* ★ 首次锚点偏移计算 */
	uint32_t conn_offset_us = (uint32_t)conn_params.win_offset * CONN_INT_UNIT_US
				+ WIN_DELAY_LEGACY
				- EVENT_TICKER_RES_MARGIN_US
				- EVENT_JITTER_US
				- radio_rx_ready_delay_get(0, 0)
				- ww_periodic_us;

	anchor.initial_anchor_us = conn_offset_us;

	/* ★ 转换为 RTC ticks + 皮秒余量 (亚 tick 精度) */
	uint32_t offset_ticks = HAL_TICKER_US_TO_TICKS(conn_offset_us);
	uint32_t offset_remainder_ps = HAL_TICKER_REMAINDER(conn_offset_us);

	uint32_t interval_ticks = HAL_TICKER_US_TO_TICKS(conn_interval_us);
	uint32_t interval_remainder_ps = HAL_TICKER_REMAINDER(conn_interval_us);

	/* 首次锚点的绝对 RTC tick */
	uint32_t first_anchor_rtc = (connect_end_rtc + offset_ticks) &
				    HAL_TICKER_CNTR_MASK;

	anchor.initial_anchor_rtc = first_anchor_rtc;
	anchor.current_anchor_rtc = first_anchor_rtc;

	/* HCTO 窗口 (首次事件用 win_size) */
	uint32_t hcto_add = ((EVENT_JITTER_US +
			      EVENT_TICKER_RES_MARGIN_US +
			      ww_periodic_us) << 1) +
			    win_size_us;

	/* ==== 执行首次连接事件 ==== */
	bool rx_ok = conn_event(first_anchor_rtc, offset_remainder_ps, hcto_add);

	printk("\n========== First Connection Event ==========\n");
	printk("  Result: %s\n", rx_ok ? "RX OK" : "RX MISS");
	printk("  RX OK count:     %u\n", conn_event_rx_ok);
	printk("  RX timeout count: %u\n", conn_event_rx_timeout);
	printk("=============================================\n");

	/* 清理 */
	NRF_RADIO->SHORTS = 0;
	NRF_RADIO->INTENCLR = 0xFFFFFFFFUL;

	/* 打印详细的锚点计算过程 (连接事件结束后打印, 避免影响定时) */
	print_connect_ind();
	print_anchor_calculation(conn_offset_us,
				 offset_ticks,
				 offset_remainder_ps,
				 interval_ticks,
				 interval_remainder_ps,
				 master_sca_ppm,
				 combined_sca_ppm,
				 ww_periodic_us,
				 conn_interval_us);
}
```

## src/conn.h
```c
/*
 * BLE PHY First Anchor Demo — 连接态
 *
 * SPDX-License-Identifier: Apache-2.0
 */

#ifndef CONN_H
#define CONN_H

#include "ble_common.h"

/* 执行首次连接事件: 计算锚点 A0, 在精确时刻 RX 一次, 然后返回 */
void conn_first_event(void);

#endif /* CONN_H */
```

## src/hal_radio.c
```c
/*
 * BLE PHY First Anchor Demo — HAL 层: 硬件初始化与 Radio 配置
 *
 * 相比 03_phy_connect_ind 新增:
 *   - radio_configure_conn(): 使用 CONNECT_IND 中的 AA/CRC 配置数据信道
 *   - data_chan_set(): BLE data channel 0-36 映射到 nRF 频率寄存器值
 *
 * SPDX-License-Identifier: Apache-2.0
 */

#include "hal_radio.h"

/*===========================================================================
 * 启动 HFCLK
 *===========================================================================*/
void hfclk_start(void)
{
	NRF_CLOCK->EVENTS_HFCLKSTARTED = 0;
	NRF_CLOCK->TASKS_HFCLKSTART = 1;

	while (NRF_CLOCK->EVENTS_HFCLKSTARTED == 0) {
	}

	printk("HFCLK started\n");
}

/*===========================================================================
 * 启动 RTC0 — 为 radio_tmr_start 提供 32768 Hz 时基
 *
 * HAL 的 radio_tmr_start 使用 RTC0 CC[2] + PPI 在精确的 tick 触发
 * TIMER0 START → RXEN/TXEN。如果 RTC0 未运行, Counter 始终为 0,
 * CC[2] 永远不会匹配, PPI 永远不会触发, 导致 Radio 死循环。
 *===========================================================================*/
void rtc0_start(void)
{
	NRF_RTC0->TASKS_STOP = 1;
	NRF_RTC0->PRESCALER = 0;     /* 32768 Hz, 无分频 */
	NRF_RTC0->TASKS_CLEAR = 1;
	NRF_RTC0->TASKS_START = 1;

	printk("RTC0 started (32768 Hz)\n");
}

/*===========================================================================
 * 确保 Radio 回到 DISABLED 状态 (含 SW TIFS 清理)
 *===========================================================================*/
void radio_ensure_disabled(void)
{
	NRF_RADIO->SHORTS = 0;

	nrf_ppi_channels_disable(NRF_PPI, BIT(PPI_CH_RXEN) | BIT(PPI_CH_TXEN));

	nrf_timer_task_trigger(NRF_TIMER1, NRF_TIMER_TASK_STOP);

	if (NRF_RADIO->STATE != RADIO_STATE_STATE_Disabled) {
		NRF_RADIO->EVENTS_DISABLED = 0;
		NRF_RADIO->TASKS_DISABLE = 1;
		while (NRF_RADIO->EVENTS_DISABLED == 0) {
		}
	}
}

/*===========================================================================
 * 配置 Radio — 广播态
 *===========================================================================*/
void radio_configure_adv(void)
{
	radio_phy_set(0, 0);
	radio_tx_power_set(0);

	radio_pkt_configure(RADIO_PKT_CONF_LENGTH_8BIT,
			    PDU_AC_LEG_PAYLOAD_SIZE_MAX,
			    RADIO_PKT_CONF_FLAGS(
				    RADIO_PKT_CONF_PDU_TYPE_AC,
				    RADIO_PKT_CONF_PHY_LEGACY,
				    RADIO_PKT_CONF_CTE_DISABLED));

	uint32_t aa = sys_cpu_to_le32(PDU_AC_ACCESS_ADDR);
	radio_aa_set((const uint8_t *)&aa);
	radio_crc_configure(PDU_CRC_POLYNOMIAL, PDU_AC_CRC_IV);

	NRF_RADIO->TIFS = 0;
}

/*===========================================================================
 * 配置 Radio — 连接态
 *
 * ★ 使用 CONNECT_IND 中协商的 Access Address 和 CRC Init!
 *   广播态用的是固定的 0x8E89BED6 / 0x555555,
 *   连接态每次连接都有唯一的 AA 和 CRC_INIT。
 *===========================================================================*/
void radio_configure_conn(void)
{
	radio_phy_set(0, 0);
	radio_tx_power_set(0);

	radio_pkt_configure(RADIO_PKT_CONF_LENGTH_8BIT,
			    PDU_DC_PAYLOAD_SIZE_MIN,
			    RADIO_PKT_CONF_FLAGS(
				    RADIO_PKT_CONF_PDU_TYPE_DC,
				    RADIO_PKT_CONF_PHY_LEGACY,
				    RADIO_PKT_CONF_CTE_DISABLED));

	radio_aa_set(conn_params.access_addr);

	uint32_t crc_iv = conn_params.crc_init[0] |
			  ((uint32_t)conn_params.crc_init[1] << 8) |
			  ((uint32_t)conn_params.crc_init[2] << 16);
	radio_crc_configure(PDU_CRC_POLYNOMIAL, crc_iv);

	NRF_RADIO->TIFS = 0;
}

/*===========================================================================
 * 配置 SW_SWITCH_TIMER (NRF_TIMER1)
 *===========================================================================*/
void sw_switch_timer_configure(void)
{
	nrf_timer_task_trigger(NRF_TIMER1, NRF_TIMER_TASK_STOP);
	nrf_timer_task_trigger(NRF_TIMER1, NRF_TIMER_TASK_CLEAR);

	NRF_TIMER1->INTENCLR = 0xFFFFFFFFUL;

	for (int i = 0; i < 6; i++) {
		NRF_TIMER1->EVENTS_COMPARE[i] = 0;
	}

	NRF_TIMER1->MODE      = TIMER_MODE_MODE_Timer;
	NRF_TIMER1->PRESCALER = 4;
	NRF_TIMER1->BITMODE   = TIMER_BITMODE_BITMODE_16Bit;

	printk("SW_SWITCH_TIMER (TIMER1) configured: 1MHz, 16-bit\n");
}

/*===========================================================================
 * 配置 PPI 通道
 *===========================================================================*/
void ppi_configure(void)
{
	nrf_ppi_channel_endpoint_setup(
		NRF_PPI,
		(nrf_ppi_channel_t)PPI_CH_TIMER_CLEAR,
		(uint32_t)&NRF_RADIO->EVENTS_END,
		(uint32_t)&NRF_TIMER1->TASKS_CLEAR);

	nrf_ppi_channel_endpoint_setup(
		NRF_PPI,
		(nrf_ppi_channel_t)PPI_CH_RXEN,
		(uint32_t)&NRF_TIMER1->EVENTS_COMPARE[CC_IDX_RXEN],
		(uint32_t)&NRF_RADIO->TASKS_RXEN);

	nrf_ppi_channel_endpoint_setup(
		NRF_PPI,
		(nrf_ppi_channel_t)PPI_CH_TXEN,
		(uint32_t)&NRF_TIMER1->EVENTS_COMPARE[CC_IDX_TXEN],
		(uint32_t)&NRF_RADIO->TASKS_TXEN);

	nrf_ppi_channels_enable(NRF_PPI, BIT(PPI_CH_TIMER_CLEAR));
	nrf_ppi_channels_disable(NRF_PPI, BIT(PPI_CH_RXEN) | BIT(PPI_CH_TXEN));

	printk("PPI configured: CH%d END→CLEAR, CH%d CC[%d]→RXEN, CH%d CC[%d]→TXEN\n",
	       PPI_CH_TIMER_CLEAR, PPI_CH_RXEN, CC_IDX_RXEN, PPI_CH_TXEN, CC_IDX_TXEN);
}

/*===========================================================================
 * 数据信道频率设置
 *
 * BLE data channel 0-36 映射到 nRF RADIO FREQUENCY 寄存器值:
 *   ch 0-10:  freq = 4 + ch*2   (2404-2424 MHz)
 *   ch 11-36: freq = 28 + (ch-11)*2  (2428-2478 MHz)
 *
 * 注意: 广播信道 37/38/39 不在此范围, 它们由 adv.c 单独处理。
 *===========================================================================*/
void data_chan_set(uint8_t chan)
{
	uint32_t freq;

	if (chan <= 10) {
		freq = 4 + (chan * 2U);
	} else if (chan <= 36) {
		freq = 28 + ((chan - 11) * 2U);
	} else {
		return;
	}

	radio_freq_chan_set(freq);
	radio_whiten_iv_set(chan);
}
```

## src/hal_radio.h
```c
/*
 * BLE PHY First Anchor Demo — HAL 层: 硬件初始化与 Radio 配置
 *
 * SPDX-License-Identifier: Apache-2.0
 */

#ifndef HAL_RADIO_INIT_H
#define HAL_RADIO_INIT_H

#include "ble_common.h"

/* 硬件初始化 */
void hfclk_start(void);
void rtc0_start(void);
void sw_switch_timer_configure(void);
void ppi_configure(void);

/* Radio 状态管理 */
void radio_ensure_disabled(void);
void radio_configure_adv(void);
void radio_configure_conn(void);

/* 数据信道频率设置 */
void data_chan_set(uint8_t chan);

#endif /* HAL_RADIO_INIT_H */
```

## src/ll_pdu.c
```c
/*
 * BLE PHY First Anchor Demo — 链路层: PDU 构造、CONNECT_IND 解析、信道选择
 *
 * 相比 03_phy_connect_ind 新增:
 *   - build_empty_pdu(): 构造空数据 PDU (连接事件 TX 响应)
 *   - chan_sel_1(): Channel Selection Algorithm #1
 *   - print_anchor_calculation(): 锚点计算 6 步详细过程输出
 *
 * SPDX-License-Identifier: Apache-2.0
 */

#include "ll_pdu.h"

/*===========================================================================
 * 辅助函数: 统计比特数
 *===========================================================================*/
uint8_t count_ones(const uint8_t *data, uint8_t len)
{
	uint8_t count = 0;

	for (uint8_t i = 0; i < len; i++) {
		uint8_t byte = data[i];

		while (byte) {
			count += byte & 1;
			byte >>= 1;
		}
	}
	return count;
}

/*===========================================================================
 * 构造 ADV_IND PDU
 *===========================================================================*/
void build_adv_ind_pdu(void)
{
	memset(&pdu_adv_ind, 0, sizeof(pdu_adv_ind));

	pdu_adv_ind.type    = PDU_ADV_TYPE_ADV_IND;
	pdu_adv_ind.tx_addr = 1;
	pdu_adv_ind.chan_sel = 0;
	pdu_adv_ind.rx_addr = 0;
	pdu_adv_ind.len     = BDADDR_SIZE + ADV_DATA_LEN;

	memcpy(pdu_adv_ind.adv_ind.addr, adv_addr, BDADDR_SIZE);
	memcpy(pdu_adv_ind.adv_ind.data, adv_data, ADV_DATA_LEN);
}

/*===========================================================================
 * 构造空数据 PDU
 *
 * 连接事件中, 即使没有数据要发, Slave 也必须回一个空 PDU
 * 以维持连接 (告知 Master: 我还在, 且我的 SN/NESN 状态是...)
 *===========================================================================*/
void build_empty_pdu(struct pdu_data *pdu)
{
	memset(pdu, 0, sizeof(*pdu));
	pdu->ll_id = PDU_DATA_LLID_DATA_CONTINUE;
	pdu->nesn  = rx_nesn;
	pdu->sn    = tx_sn;
	pdu->md    = 0;
	pdu->len   = 0;
}

/*===========================================================================
 * 验证 CONNECT_IND
 *===========================================================================*/
bool validate_connect_ind(const struct pdu_adv *rx_pdu)
{
	if (rx_pdu->type != PDU_ADV_TYPE_CONNECT_IND) {
		return false;
	}
	if (rx_pdu->len != sizeof(struct pdu_adv_connect_ind)) {
		return false;
	}
	if (memcmp(rx_pdu->connect_ind.adv_addr, adv_addr, BDADDR_SIZE) != 0) {
		return false;
	}
	return true;
}

/*===========================================================================
 * 解析 CONNECT_IND
 *===========================================================================*/
void parse_connect_ind(const struct pdu_adv *rx_pdu)
{
	const struct pdu_adv_connect_ind *ci = &rx_pdu->connect_ind;

	memcpy(conn_params.peer_addr, ci->init_addr, BDADDR_SIZE);
	memcpy(conn_params.access_addr, ci->access_addr, 4);
	memcpy(conn_params.crc_init, ci->crc_init, 3);

	conn_params.win_size   = ci->win_size;
	conn_params.win_offset = sys_le16_to_cpu(ci->win_offset);
	conn_params.interval   = sys_le16_to_cpu(ci->interval);
	conn_params.latency    = sys_le16_to_cpu(ci->latency);
	conn_params.timeout    = sys_le16_to_cpu(ci->timeout);

	memcpy(conn_params.chan_map, ci->chan_map, PDU_CHANNEL_MAP_SIZE);
	conn_params.hop = ci->hop;
	conn_params.sca = ci->sca;
	conn_params.chan_count = count_ones(conn_params.chan_map,
					    PDU_CHANNEL_MAP_SIZE);
}

/*===========================================================================
 * 打印 CONNECT_IND 参数
 *===========================================================================*/
void print_connect_ind(void)
{
	uint32_t aa_val = sys_get_le32(conn_params.access_addr);
	uint32_t crc_val = conn_params.crc_init[0] |
			   ((uint32_t)conn_params.crc_init[1] << 8) |
			   ((uint32_t)conn_params.crc_init[2] << 16);

	printk("\n========== CONNECT_IND Received ==========\n");
	printk("  Peer:       %02X:%02X:%02X:%02X:%02X:%02X\n",
	       conn_params.peer_addr[5], conn_params.peer_addr[4],
	       conn_params.peer_addr[3], conn_params.peer_addr[2],
	       conn_params.peer_addr[1], conn_params.peer_addr[0]);
	printk("  AA:         0x%08X\n", aa_val);
	printk("  CRC Init:   0x%06X\n", crc_val);
	printk("  WinSize:    %d (x1.25ms = %d us)\n",
	       conn_params.win_size,
	       (uint32_t)conn_params.win_size * CONN_INT_UNIT_US);
	printk("  WinOffset:  %d (x1.25ms = %d us)\n",
	       conn_params.win_offset,
	       (uint32_t)conn_params.win_offset * CONN_INT_UNIT_US);
	printk("  Interval:   %d (x1.25ms = %d us)\n",
	       conn_params.interval,
	       (uint32_t)conn_params.interval * CONN_INT_UNIT_US);
	printk("  Latency:    %d\n", conn_params.latency);
	printk("  Timeout:    %d (x10ms = %d ms)\n", conn_params.timeout,
	       (uint32_t)conn_params.timeout * 10);
	printk("  Hop:        %d\n", conn_params.hop);
	printk("  SCA:        %d (%d ppm)\n", conn_params.sca,
	       sca_ppm_table[conn_params.sca & 0x07]);
	printk("  Chan Count: %d / 37\n", conn_params.chan_count);
	printk("  T0 (RTC0):  %u ticks\n", connect_end_rtc);
	printk("==========================================\n");
}

/*===========================================================================
 * 打印锚点计算的详细过程 (本 Demo 核心教学输出)
 *===========================================================================*/
void print_anchor_calculation(uint32_t conn_offset_us,
			      uint32_t offset_ticks,
			      uint32_t offset_remainder_ps,
			      uint32_t interval_ticks,
			      uint32_t interval_remainder_ps,
			      uint16_t master_sca_ppm,
			      uint32_t combined_sca_ppm,
			      uint32_t ww_periodic_us,
			      uint32_t conn_interval_us)
{
	printk("\n===== Anchor Point Calculation =====\n");
	printk("\n[Step 1] T0: CONNECT_IND end time\n");
	printk("  connect_end_rtc = %u (RTC0 ticks, 32768 Hz)\n",
	       connect_end_rtc);
	printk("  T0 = %u x 30.52us = ~%u us\n",
	       connect_end_rtc,
	       HAL_TICKER_TICKS_TO_US(connect_end_rtc));

	printk("\n[Step 2] Calculate first anchor offset\n");
	printk("  BLE Spec formula:\n");
	printk("    A0 = T0 + winOffset*1.25ms + transmitWindowDelay\n");
	printk("  Implementation adds margins:\n");
	printk("    conn_offset_us = winOffset*1250 + WIN_DELAY(1250)\n");
	printk("                   - TICKER_RES_MARGIN(%d)\n",
	       EVENT_TICKER_RES_MARGIN_US);
	printk("                   - EVENT_JITTER(%d)\n",
	       EVENT_JITTER_US);
	printk("                   - rx_ready_delay(%d)\n",
	       radio_rx_ready_delay_get(0, 0));
	printk("                   - ww_periodic(%d)\n", ww_periodic_us);
	printk("    = %d*1250 + 1250 - %d - %d - %d - %d\n",
	       conn_params.win_offset,
	       EVENT_TICKER_RES_MARGIN_US,
	       EVENT_JITTER_US,
	       radio_rx_ready_delay_get(0, 0),
	       ww_periodic_us);
	printk("    = %u us\n", conn_offset_us);

	printk("\n[Step 3] Convert to RTC ticks + remainder\n");
	printk("  RTC runs at 32768 Hz, 1 tick = 30.517578125 us\n");
	printk("  offset_ticks     = %u\n", offset_ticks);
	printk("  offset_remainder = %u ps (sub-tick precision)\n",
	       offset_remainder_ps);

	printk("\n[Step 4] First anchor point (absolute RTC tick)\n");
	printk("  initial_anchor = connect_end_rtc + offset_ticks\n");
	printk("                 = %u + %u = %u\n",
	       connect_end_rtc, offset_ticks,
	       anchor.initial_anchor_rtc);

	printk("\n[Step 5] connInterval in RTC ticks\n");
	printk("  interval = %u us\n", conn_interval_us);
	printk("  interval_ticks     = %u\n", interval_ticks);
	printk("  interval_remainder = %u ps\n", interval_remainder_ps);
	printk("  (remainder accumulates each event, carries +1 tick\n");
	printk("   when >= 1 tick period, preventing drift)\n");

	printk("\n[Step 6] Window Widening parameters\n");
	printk("  Master SCA: %d ppm\n", master_sca_ppm);
	printk("  Local SCA:  %d ppm\n", LOCAL_SCA_PPM);
	printk("  Combined:   %d ppm\n", combined_sca_ppm);
	printk("  WW periodic = ceil(%d * %d / 1000000) = %d us/event\n",
	       combined_sca_ppm, conn_interval_us, ww_periodic_us);

	printk("\n===== Anchor Sequence Preview =====\n");
	printk("  A0 (first)  : RTC tick %u\n", anchor.initial_anchor_rtc);
	uint32_t a1 = (anchor.initial_anchor_rtc + interval_ticks) &
		      HAL_TICKER_CNTR_MASK;
	uint32_t a2 = (a1 + interval_ticks) & HAL_TICKER_CNTR_MASK;
	printk("  A1 (A0+intv) : RTC tick %u (delta=%u ticks)\n",
	       a1, interval_ticks);
	printk("  A2 (A1+intv) : RTC tick %u (delta=%u ticks)\n",
	       a2, interval_ticks);
	printk("  (remainder carry may add +1 tick per event)\n");
	printk("=====================================\n\n");
}

/*===========================================================================
 * Channel Selection Algorithm #1
 *
 * BLE Core Spec Vol 6, Part B, 4.5.8.1:
 *   unmappedChannel = (lastUnmappedChannel + hopIncrement) mod 37
 *   if unmappedChannel is used → return it
 *   else remap: remappingIndex = unmappedChannel mod numUsedChannels
 *===========================================================================*/
uint8_t chan_sel_1(void)
{
	uint8_t unmapped;

	unmapped = (last_unmapped_chan + conn_params.hop) % 37;
	last_unmapped_chan = unmapped;

	if (conn_params.chan_map[unmapped >> 3] & (1U << (unmapped & 7))) {
		return unmapped;
	}

	uint8_t remap_index = unmapped % conn_params.chan_count;
	uint8_t count = 0;

	for (uint8_t i = 0; i < 37; i++) {
		if (conn_params.chan_map[i >> 3] & (1U << (i & 7))) {
			if (count == remap_index) {
				return i;
			}
			count++;
		}
	}

	return 0;
}
```

## src/ll_pdu.h
```c
/*
 * BLE PHY First Anchor Demo — 链路层: PDU 构造、CONNECT_IND 解析、信道选择
 *
 * SPDX-License-Identifier: Apache-2.0
 */

#ifndef LL_PDU_H
#define LL_PDU_H

#include "ble_common.h"

/* 辅助函数 */
uint8_t count_ones(const uint8_t *data, uint8_t len);

/* ADV PDU */
void build_adv_ind_pdu(void);

/* Data PDU */
void build_empty_pdu(struct pdu_data *pdu);

/* CONNECT_IND */
bool validate_connect_ind(const struct pdu_adv *rx_pdu);
void parse_connect_ind(const struct pdu_adv *rx_pdu);
void print_connect_ind(void);
void print_anchor_calculation(uint32_t conn_offset_us,
			      uint32_t offset_ticks,
			      uint32_t offset_remainder_ps,
			      uint32_t interval_ticks,
			      uint32_t interval_remainder_ps,
			      uint16_t master_sca_ppm,
			      uint32_t combined_sca_ppm,
			      uint32_t ww_periodic_us,
			      uint32_t conn_interval_us);

/* Channel Selection */
uint8_t chan_sel_1(void);

#endif /* LL_PDU_H */
```
