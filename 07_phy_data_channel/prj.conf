## CMakeLists.txt
```
# SPDX-License-Identifier: Apache-2.0

cmake_minimum_required(VERSION 3.20.0)
find_package(Zephyr REQUIRED HINTS $ENV{ZEPHYR_BASE})
project(ble_phy_data_channel)

target_sources(app PRIVATE
  src/main.c
  src/hal_radio.c
  src/ll_pdu.c
  src/adv.c
  src/conn.c
  src/l2cap.c
)

# Add BLE controller internal include paths so we can use HAL APIs and PDU structs
target_include_directories(app PRIVATE
  ${ZEPHYR_BASE}/subsys/bluetooth/controller
  ${ZEPHYR_BASE}/subsys/bluetooth/controller/include
  ${ZEPHYR_BASE}/subsys/bluetooth/controller/ll_sw/nordic
  ${ZEPHYR_BASE}/subsys/bluetooth/controller/ll_sw
  ${ZEPHYR_BASE}/subsys/bluetooth/controller/ll_sw/nordic/lll
)
```

## prj.conf
```kconfig
# BLE PHY Data Channel Demo
# 演示 L2CAP 基本帧的分片、重组与回环

CONFIG_GPIO=y
CONFIG_SERIAL=y
CONFIG_CONSOLE=y
CONFIG_UART_CONSOLE=y
CONFIG_PRINTK=y

# 启用 BLE Controller (Split Link Layer) — 编译 HAL 代码
CONFIG_BT=y
CONFIG_BT_LL_SW_SPLIT=y
CONFIG_BT_BROADCASTER=y
CONFIG_BT_PERIPHERAL=y

# 不需要 Host 层功能
CONFIG_BT_OBSERVER=n
CONFIG_BT_CENTRAL=n
```

## src/main.c
```c
/*
 * BLE PHY Data Channel (数据信道) Demo
 *
 * 本 Demo 在 06_phy_anchor 的基础上增加了 L2CAP 数据通道功能:
 *
 * ┌─────────────────────────────────────────────────────────────────┐
 * │  新增功能                                                       │
 * │                                                                 │
 * │  1. LL Data PDU 收发: 区分 LLID=Start/Continue/Control         │
 * │  2. L2CAP 帧重组: 将多个分片合并为完整的 L2CAP Basic Frame     │
 * │  3. L2CAP 帧分片: 将完整帧拆分为 ≤27 字节的 PDU 分片          │
 * │  4. Echo 回环: 收到的 L2CAP 数据原样发回, 验证数据通道工作     │
 * └─────────────────────────────────────────────────────────────────┘
 *
 * L2CAP Basic Frame 格式:
 *
 *   字节偏移  字段           说明
 *   [0..1]    Length (LE)    Payload 长度 (不含此 4 字节 header)
 *   [2..3]    Channel ID     0x0004=ATT, 0x0005=L2CAP Signaling, 0x0006=SMP
 *   [4..]     Payload        上层数据 (ATT/SMP/...)
 *
 * 空口分片过程 (以 40 字节 ATT 数据为例):
 *
 *   L2CAP Frame: [Length=40] [CID=0x0004] [40 bytes ATT data]
 *   Total = 44 bytes
 *
 *   LL PDU #1: LLID=Start,     len=27, payload=[L2CAP hdr + 前 23 bytes]
 *   LL PDU #2: LLID=Continue,  len=17, payload=[后 17 bytes]
 *
 * 代码结构 (在 03 基础上新增 l2cap 模块):
 *   ble_common.h  — 公共类型 (新增 L2CAP 常量、重组缓冲区、TX 队列)
 *   hal_radio.c/h — HAL 层 (与 03 相同)
 *   ll_pdu.c/h    — 链路层 PDU (新增 LL_LENGTH_RSP)
 *   adv.c/h       — 广播态 (与 03 相同)
 *   conn.c/h      — 连接态 (新增: 数据 PDU 处理、L2CAP 分片发送)
 *   l2cap.c/h     — ★ 新增: L2CAP 帧重组、分片、回环处理
 *   main.c        — 全局变量定义与主状态机
 *
 * SPDX-License-Identifier: Apache-2.0
 */

#include "ble_common.h"
#include "hal_radio.h"
#include "ll_pdu.h"
#include "adv.h"
#include "conn.h"
#include "l2cap.h"

/*===========================================================================
 * 全局变量定义
 *===========================================================================*/

const uint8_t adv_addr[BDADDR_SIZE] = {
	0x11, 0x22, 0x33, 0x44, 0x55, 0x66
};

const uint8_t adv_data[] = {
	0x02, 0x01, 0x06,
	0x08, 0x09, 'D', 'a', 't', 'a', 'C', 'h', 'a'
};

struct conn_param conn_params;

uint8_t tx_sn;
uint8_t rx_nesn;
uint16_t conn_event_counter;
uint8_t last_unmapped_chan;
volatile bool conn_terminated;

struct pdu_data tx_pdu_buf __aligned(4);
bool tx_pdu_pending;

struct pdu_adv pdu_adv_ind __aligned(4);
struct pdu_adv pdu_adv_rx __aligned(4);
struct pdu_data pdu_data_rx __aligned(4);

uint32_t connect_end_rtc;

const uint16_t sca_ppm_table[] = {500, 250, 150, 100, 75, 50, 30, 20};

struct anchor_tracker anchor;

volatile uint32_t adv_event_count;
volatile uint32_t conn_event_rx_ok;
volatile uint32_t conn_event_rx_timeout;
volatile uint32_t conn_event_rx_crc_err;

uint32_t last_rx_aa_us;
uint32_t last_rx_ready_us;

/* L2CAP 重组缓冲区 */
struct l2cap_reassembly l2cap_reasm;

/* 数据 TX 队列 */
struct tx_queue data_tx_q;

/* 数据统计 */
uint32_t l2cap_rx_count;
uint32_t l2cap_tx_count;

/* L2CAP 延迟日志 */
uint16_t l2cap_last_rx_cid;
uint16_t l2cap_last_rx_len;
int      l2cap_last_tx_frags;
bool     l2cap_last_rx_pending;

/*===========================================================================
 * 主函数
 *===========================================================================*/
int main(void)
{
	printk("\n");
	printk("===================================================\n");
	printk("  BLE PHY Data Channel Demo\n");
	printk("  演示 L2CAP 数据帧的分片、重组与回环\n");
	printk("===================================================\n");
	printk("Device: %s  Addr: %02X:%02X:%02X:%02X:%02X:%02X\n",
	       ADV_NAME,
	       adv_addr[5], adv_addr[4], adv_addr[3],
	       adv_addr[2], adv_addr[1], adv_addr[0]);
	printk("\n");
	printk("数据通道功能:\n");
	printk("  1. 接收 LL Data PDU (LLID=Start/Continue)\n");
	printk("  2. 重组为完整 L2CAP Basic Frame\n");
	printk("  3. 拆分为 <=27 字节的 PDU 分片发回 (Echo)\n");
	printk("\n");

	hfclk_start();
	rtc0_start();
	sw_switch_timer_configure();
	ppi_configure();

	while (1) {
		printk("[STATE] Entering ADVERTISING state\n");
		adv_event_count = 0;

		radio_configure_adv();
		build_adv_ind_pdu();

		bool connected = false;
		while (!connected) {
			int ret = adv_event();
			if (ret == 1) {
				connected = true;
			} else {
				k_msleep(ADV_INTERVAL_MS);
			}
		}

		conn_loop();

		printk("[STATE] Connection lost, returning to advertising...\n\n");
		radio_ensure_disabled();
		k_msleep(100);
	}

	return 0;
}
```

## src/ble_common.h
```c
/*
 * BLE PHY Data Channel Demo — 公共类型、常量与全局变量声明
 *
 * SPDX-License-Identifier: Apache-2.0
 */

#ifndef BLE_COMMON_H
#define BLE_COMMON_H

#include <zephyr/kernel.h>
#include <zephyr/sys/printk.h>
#include <zephyr/sys/byteorder.h>
#include <string.h>
#include <soc.h>
#include <hal/nrf_clock.h>
#include <hal/nrf_timer.h>
#include <hal/nrf_ppi.h>

/* ---- Controller HAL 层头文件 ---- */
#include "hal/ccm.h"
#include "hal/radio.h"

/* ---- Controller PDU 结构体定义 ---- */
#include "pdu_df.h"
#include "pdu_vendor.h"
#include "pdu.h"

/* ---- Zephyr 控制器 Ticker 定时层 ---- */
#include "hal/ticker.h"

/*===========================================================================
 * 配置参数
 *===========================================================================*/

#define ADV_INTERVAL_MS  100
#define T_IFS_US         150
#define ADV_RX_TIMEOUT_US  600

/* BLE 定时常量 */
#define WIN_DELAY_LEGACY            1250
#define CONN_INT_UNIT_US            1250
#define EVENT_JITTER_US             16
#define EVENT_TICKER_RES_MARGIN_US  31
#define ADDR_US_1M                  40
#define RTC0_CMP_OFFSET_MIN         3

#define ADV_NAME         "DataCh"

#define RX_RAMP_US       40
#define TX_RAMP_US       40

#define RX_CHAIN_DELAY_1M_US  10
#define TX_CHAIN_DELAY_US      1

/*===========================================================================
 * PPI 通道分配 (SW TIFS)
 *===========================================================================*/
#define PPI_CH_TIMER_CLEAR  14
#define PPI_CH_RXEN         15
#define PPI_CH_TXEN         16

#define CC_IDX_RXEN  0
#define CC_IDX_TXEN  1

#define LOCAL_SCA_PPM 50

/*===========================================================================
 * L2CAP 常量
 *===========================================================================*/
#define L2CAP_CID_ATT       0x0004  /* Attribute Protocol */
#define L2CAP_CID_SIG       0x0005  /* L2CAP Signaling */
#define L2CAP_CID_SMP       0x0006  /* Security Manager */
#define L2CAP_HDR_SIZE      4       /* Length(2) + CID(2) */
#define L2CAP_MAX_PAYLOAD   512     /* 最大 L2CAP SDU */

/* LL Data PDU 默认最大 payload = 27 字节 (BLE 4.0/4.1) */
#define LL_DATA_MTU_DEFAULT 27

/*===========================================================================
 * 连接参数结构体
 *===========================================================================*/
struct conn_param {
	uint8_t  access_addr[4];
	uint8_t  crc_init[3];
	uint8_t  win_size;
	uint16_t win_offset;
	uint16_t interval;
	uint16_t latency;
	uint16_t timeout;
	uint8_t  chan_map[PDU_CHANNEL_MAP_SIZE];
	uint8_t  hop;
	uint8_t  sca;
	uint8_t  chan_count;
	uint8_t  peer_addr[BDADDR_SIZE];
};

/*===========================================================================
 * 锚点追踪结构体
 *===========================================================================*/
struct anchor_tracker {
	uint32_t initial_anchor_rtc;
	uint32_t initial_anchor_us;
	uint32_t current_anchor_rtc;
	uint32_t last_rx_anchor_rtc;
	uint32_t ww_current_us;
	uint32_t ww_periodic_us;
	uint32_t ww_max_us;
	uint32_t win_size_event_us;
	uint32_t anchor_update_count;
	uint32_t consecutive_misses;
	uint32_t max_consecutive_misses;
};

/*===========================================================================
 * L2CAP 重组缓冲区
 *===========================================================================*/
struct l2cap_reassembly {
	uint8_t  buf[L2CAP_MAX_PAYLOAD + L2CAP_HDR_SIZE];
	uint16_t expected_len;  /* L2CAP Length 字段值 + 4 (header) */
	uint16_t received_len;  /* 已接收字节数 */
	bool     in_progress;   /* 正在重组 */
};

/*===========================================================================
 * 数据 TX 队列 (简单环形缓冲)
 *===========================================================================*/
#define TX_QUEUE_SIZE  4

struct tx_frag {
	uint8_t  data[LL_DATA_MTU_DEFAULT];
	uint8_t  len;
	uint8_t  llid;  /* PDU_DATA_LLID_DATA_START or _CONTINUE */
};

struct tx_queue {
	struct tx_frag frags[TX_QUEUE_SIZE];
	uint8_t head;
	uint8_t tail;
	uint8_t count;
};

/*===========================================================================
 * 全局变量声明 (定义在 main.c)
 *===========================================================================*/

extern const uint8_t adv_addr[BDADDR_SIZE];
extern const uint8_t adv_data[];
#define ADV_DATA_LEN 14

extern struct conn_param conn_params;

/* 连接态变量 */
extern uint8_t tx_sn;
extern uint8_t rx_nesn;
extern uint16_t conn_event_counter;
extern uint8_t last_unmapped_chan;
extern volatile bool conn_terminated;

extern struct pdu_data tx_pdu_buf;
extern bool tx_pdu_pending;

/* PDU 缓冲区 */
extern struct pdu_adv pdu_adv_ind;
extern struct pdu_adv pdu_adv_rx;
extern struct pdu_data pdu_data_rx;

/* CONNECT_IND 接收时刻 */
extern uint32_t connect_end_rtc;

/* SCA PPM 映射表 */
extern const uint16_t sca_ppm_table[];

/* 锚点追踪 */
extern struct anchor_tracker anchor;

/* 统计 */
extern volatile uint32_t adv_event_count;
extern volatile uint32_t conn_event_rx_ok;
extern volatile uint32_t conn_event_rx_timeout;
extern volatile uint32_t conn_event_rx_crc_err;

/* Drift correction */
extern uint32_t last_rx_aa_us;
extern uint32_t last_rx_ready_us;

/* L2CAP 重组 */
extern struct l2cap_reassembly l2cap_reasm;

/* 数据 TX 队列 */
extern struct tx_queue data_tx_q;

/* 数据统计 */
extern uint32_t l2cap_rx_count;
extern uint32_t l2cap_tx_count;

/* L2CAP 延迟日志 (在 conn_event 结束后打印, 避免阻塞 TIFS) */
extern uint16_t l2cap_last_rx_cid;
extern uint16_t l2cap_last_rx_len;
extern int      l2cap_last_tx_frags;
extern bool     l2cap_last_rx_pending;

#endif /* BLE_COMMON_H */
```

## src/conn.c
```c
/*
 * BLE PHY Data Channel Demo — 连接态: 连接事件、数据 PDU 收发与锚点调度
 *
 * 相比 06_phy_anchor 的变化:
 *   1. conn_event() 现在处理 LL Data PDU (LLID=10/01), 不仅仅是 LL Control
 *   2. 接收到的数据分片送入 L2CAP 重组模块
 *   3. 发送队列: 优先发 LL Control 回复, 其次发 L2CAP 回环数据
 *   4. MD 位支持: 如果 TX 队列还有数据, 设 MD=1 请求连续发送
 *
 * SPDX-License-Identifier: Apache-2.0
 */

#include "conn.h"
#include "hal_radio.h"
#include "ll_pdu.h"
#include "l2cap.h"

/*===========================================================================
 * 单个连接事件
 *===========================================================================*/
static bool conn_event(uint32_t ticks_at_start, uint32_t remainder_ps,
		       uint32_t hcto_add)
{
	uint32_t ahead = (ticks_at_start - NRF_RTC0->COUNTER) &
			 HAL_TICKER_CNTR_MASK;
	if (ahead > (HAL_TICKER_CNTR_MASK >> 1) ||
	    ahead < RTC0_CMP_OFFSET_MIN) {
		(void)chan_sel_1();
		conn_event_rx_timeout++;
		conn_event_counter++;
		return false;
	}

	uint8_t chan = chan_sel_1();
	data_chan_set(chan);

	NRF_RADIO->INTENCLR = 0xFFFFFFFFUL;
	radio_status_reset();
	radio_tmr_status_reset();

	NRF_RADIO->SHORTS = RADIO_SHORTS_READY_START_Msk |
			    RADIO_SHORTS_END_DISABLE_Msk;

	nrf_ppi_channels_disable(NRF_PPI, BIT(PPI_CH_RXEN) | BIT(PPI_CH_TXEN));

	nrf_timer_cc_set(NRF_TIMER1, (nrf_timer_cc_channel_t)CC_IDX_TXEN,
			 T_IFS_US - TX_RAMP_US - RX_CHAIN_DELAY_1M_US);

	nrf_timer_task_trigger(NRF_TIMER1, NRF_TIMER_TASK_CLEAR);
	nrf_timer_task_trigger(NRF_TIMER1, NRF_TIMER_TASK_START);

	radio_pkt_rx_set(&pdu_data_rx);

	nrf_timer_task_trigger(NRF_TIMER0, NRF_TIMER_TASK_STOP);
	NRF_RTC0->EVENTS_COMPARE[2] = 0;

	uint32_t remainder_us = radio_tmr_start(0, ticks_at_start,
						remainder_ps);

	radio_tmr_aa_capture();
	radio_tmr_aa_save(0);

	uint32_t hcto = remainder_us + hcto_add +
			radio_rx_ready_delay_get(0, 0) +
			ADDR_US_1M +
			radio_rx_chain_delay_get(0, 0);
	radio_tmr_hcto_configure(hcto);
	radio_tmr_end_capture();

	/* 等待 RX 完成或 HCTO 超时 */
	{
		uint32_t safety = 0;
		while (NRF_RADIO->EVENTS_DISABLED == 0) {
			if (++safety > 5000000) {
				NRF_RADIO->TASKS_DISABLE = 1;
				while (NRF_RADIO->EVENTS_DISABLED == 0) {
				}
				conn_event_rx_timeout++;
				conn_event_counter++;
				return false;
			}
		}
	}
	NRF_RADIO->EVENTS_DISABLED = 0;

	if (!radio_is_done()) {
		radio_ensure_disabled();
		conn_event_rx_timeout++;
		conn_event_counter++;
		return false;
	}

	if (!radio_crc_is_valid()) {
		radio_ensure_disabled();
		conn_event_rx_crc_err++;
		conn_event_counter++;
		return false;
	}

	conn_event_rx_ok++;

	last_rx_aa_us = radio_tmr_aa_get();
	last_rx_ready_us = radio_tmr_ready_get();

	/*==============================================================
	 * RX→TX 转换 (SW TIFS)
	 *==============================================================*/
	NRF_TIMER1->EVENTS_COMPARE[CC_IDX_TXEN] = 0;
	(void)NRF_TIMER1->EVENTS_COMPARE[CC_IDX_TXEN];
	NRF_TIMER1->EVENTS_COMPARE[CC_IDX_RXEN] = 0;
	(void)NRF_TIMER1->EVENTS_COMPARE[CC_IDX_RXEN];

	/* SN/NESN 流控 */
	if (pdu_data_rx.nesn != tx_sn) {
		tx_sn = pdu_data_rx.nesn;
	}
	bool new_packet = false;
	if (pdu_data_rx.sn == rx_nesn) {
		new_packet = true;
		rx_nesn ^= 1;
	}

	/*==============================================================
	 * ★ 数据 PDU 处理 — 本 Demo 的核心新增功能
	 *
	 * LL Data PDU 的 LLID 字段区分数据类型:
	 *   LLID=11 (0x03): LL Control — 链路层控制包
	 *   LLID=10 (0x02): Data Start — L2CAP 帧的第一个分片
	 *   LLID=01 (0x01): Data Continue — L2CAP 帧的后续分片
	 *   LLID=01 + len=0: Empty PDU — 空包 (ACK only)
	 *==============================================================*/
	tx_pdu_pending = false;

	if (new_packet && pdu_data_rx.len > 0) {
		if (pdu_data_rx.ll_id == PDU_DATA_LLID_CTRL) {
			/* LL Control: 与 03 相同的处理 */
			tx_pdu_pending = handle_ll_control(&pdu_data_rx);
		} else if (pdu_data_rx.ll_id == PDU_DATA_LLID_DATA_START ||
			   pdu_data_rx.ll_id == PDU_DATA_LLID_DATA_CONTINUE) {
			/* ★ L2CAP 数据分片: 送入重组模块 */
			bool complete = l2cap_rx_fragment(
				pdu_data_rx.ll_id,
				pdu_data_rx.lldata,
				pdu_data_rx.len);

			if (complete) {
				/* 完整 L2CAP 帧重组完成 → 处理 (echo) */
				l2cap_process_complete();
			}
		}
	}

	/* ★ 准备 TX 包: 优先级
	 *   1. LL Control 回复 (tx_pdu_pending = true)
	 *   2. L2CAP TX 队列中的数据分片
	 *   3. 空包 (ACK only) */
	if (tx_pdu_pending) {
		tx_pdu_buf.nesn = rx_nesn;
		tx_pdu_buf.sn   = tx_sn;
		radio_pkt_tx_set(&tx_pdu_buf);
	} else if (l2cap_tx_dequeue(&tx_pdu_buf)) {
		/* 从 L2CAP TX 队列取出数据分片 */
		tx_pdu_buf.nesn = rx_nesn;
		tx_pdu_buf.sn   = tx_sn;
		tx_pdu_pending = true;
		radio_pkt_tx_set(&tx_pdu_buf);
	} else {
		build_empty_pdu(&tx_pdu_buf);
		radio_pkt_tx_set(&tx_pdu_buf);
	}

	/* 启用 PPI_CH_TXEN */
	nrf_ppi_channels_enable(NRF_PPI, BIT(PPI_CH_TXEN));

	NRF_RADIO->EVENTS_END = 0;
	NRF_RADIO->EVENTS_DISABLED = 0;

	/* 等待 TX 完成 */
	{
		uint32_t safety = 0;
		while (NRF_RADIO->EVENTS_DISABLED == 0) {
			if (++safety > 2000000) {
				NRF_RADIO->TASKS_DISABLE = 1;
				while (NRF_RADIO->EVENTS_DISABLED == 0) {
				}
				break;
			}
		}
	}
	NRF_RADIO->EVENTS_DISABLED = 0;

	nrf_ppi_channels_disable(NRF_PPI, BIT(PPI_CH_TXEN));
	NRF_RADIO->SHORTS = 0;

	if (tx_pdu_pending) {
		tx_sn ^= 1;
	}

	conn_event_counter++;
	return true;
}

/*===========================================================================
 * 连接态主循环
 *===========================================================================*/
void conn_loop(void)
{
	tx_sn = 0;
	rx_nesn = 0;
	conn_event_counter = 0;
	last_unmapped_chan = 0;
	conn_terminated = false;
	tx_pdu_pending = false;
	conn_event_rx_ok = 0;
	conn_event_rx_timeout = 0;
	conn_event_rx_crc_err = 0;

	memset(&anchor, 0, sizeof(anchor));
	l2cap_init();

	radio_configure_conn();
	print_connect_ind();

	uint32_t conn_interval_us = (uint32_t)conn_params.interval * CONN_INT_UNIT_US;
	uint32_t win_size_us = (uint32_t)conn_params.win_size * CONN_INT_UNIT_US;

	uint16_t master_sca_ppm = sca_ppm_table[conn_params.sca & 0x07];
	uint32_t combined_sca_ppm = (uint32_t)master_sca_ppm + LOCAL_SCA_PPM;
	uint32_t ww_periodic_us = DIV_ROUND_UP(
		combined_sca_ppm * conn_interval_us, 1000000);
	uint32_t ww_max_us = (conn_interval_us >> 1) - T_IFS_US;

	anchor.ww_periodic_us = ww_periodic_us;
	anchor.ww_max_us = ww_max_us;

	uint32_t ww_event_us = 0;
	uint32_t win_size_event_us = win_size_us;
	anchor.win_size_event_us = win_size_us;

	uint32_t conn_offset_us = (uint32_t)conn_params.win_offset * CONN_INT_UNIT_US
				+ WIN_DELAY_LEGACY
				- EVENT_TICKER_RES_MARGIN_US
				- EVENT_JITTER_US
				- radio_rx_ready_delay_get(0, 0)
				- ww_periodic_us;

	anchor.initial_anchor_us = conn_offset_us;

	uint32_t offset_ticks = HAL_TICKER_US_TO_TICKS(conn_offset_us);
	uint32_t offset_remainder_ps = HAL_TICKER_REMAINDER(conn_offset_us);

	uint32_t interval_ticks = HAL_TICKER_US_TO_TICKS(conn_interval_us);
	uint32_t interval_remainder_ps = HAL_TICKER_REMAINDER(conn_interval_us);

	uint32_t ps_per_tick = HAL_TICKER_CNTR_CLK_UNIT_FSEC /
			       HAL_TICKER_FSEC_PER_PSEC;

	uint32_t next_event_rtc = (connect_end_rtc + offset_ticks) &
				  HAL_TICKER_CNTR_MASK;
	uint32_t next_event_remainder_ps = offset_remainder_ps;

	anchor.initial_anchor_rtc = next_event_rtc;
	anchor.current_anchor_rtc = next_event_rtc;
	anchor.last_rx_anchor_rtc = connect_end_rtc;

	uint32_t supervision_timeout_us = (uint32_t)conn_params.timeout * 10000;
	uint32_t last_rx_rtc = connect_end_rtc;

	while (!conn_terminated) {
		ww_event_us += ww_periodic_us;
		if (ww_event_us > ww_max_us) {
			ww_event_us = ww_max_us;
		}
		anchor.ww_current_us = ww_event_us;

		uint32_t hcto_add = ((EVENT_JITTER_US +
				      EVENT_TICKER_RES_MARGIN_US +
				      ww_event_us) << 1) +
				    win_size_event_us;

		anchor.current_anchor_rtc = next_event_rtc;

		bool rx_ok = conn_event(next_event_rtc,
					next_event_remainder_ps,
					hcto_add);

		if (rx_ok) {
			uint32_t actual_s2a = last_rx_aa_us - last_rx_ready_us;
			int32_t drift_us = (int32_t)actual_s2a -
				(int32_t)(EVENT_JITTER_US +
					  EVENT_TICKER_RES_MARGIN_US +
					  ADDR_US_1M);

			int64_t adj_ps = (int64_t)next_event_remainder_ps +
					 (int64_t)drift_us * 1000000LL;

			while (adj_ps >= (int64_t)ps_per_tick) {
				adj_ps -= ps_per_tick;
				next_event_rtc = (next_event_rtc + 1) &
						 HAL_TICKER_CNTR_MASK;
			}
			while (adj_ps < 0) {
				adj_ps += ps_per_tick;
				next_event_rtc = (next_event_rtc - 1) &
						 HAL_TICKER_CNTR_MASK;
			}
			next_event_remainder_ps = (uint32_t)adj_ps;

			last_rx_rtc = next_event_rtc;
			anchor.last_rx_anchor_rtc = next_event_rtc;
			anchor.anchor_update_count++;
			anchor.consecutive_misses = 0;

			ww_event_us = 0;
			win_size_event_us = 0;
			anchor.ww_current_us = 0;
			anchor.win_size_event_us = 0;
		} else {
			anchor.consecutive_misses++;
			if (anchor.consecutive_misses > anchor.max_consecutive_misses) {
				anchor.max_consecutive_misses = anchor.consecutive_misses;
			}

			uint32_t elapsed_ticks = (next_event_rtc - last_rx_rtc) &
						 HAL_TICKER_CNTR_MASK;
			uint32_t elapsed_us = HAL_TICKER_TICKS_TO_US(elapsed_ticks);

			if (elapsed_us >= supervision_timeout_us) {
				printk("[CONN] Supervision timeout! no RX for %u us\n",
				       elapsed_us);
				break;
			}
		}

		/* 锚点递推 */
		next_event_rtc = (next_event_rtc + interval_ticks) &
				 HAL_TICKER_CNTR_MASK;
		next_event_remainder_ps += interval_remainder_ps;
		if (next_event_remainder_ps >= ps_per_tick) {
			next_event_remainder_ps -= ps_per_tick;
			next_event_rtc = (next_event_rtc + 1) &
					 HAL_TICKER_CNTR_MASK;
		}

		uint32_t current_event = conn_event_counter;

		if (current_event <= 5 || anchor.consecutive_misses > 3) {
			printk("[CONN] #%u ch=%u %s | ww=%u | rx=%u/%u l2cap_rx=%u tx=%u\n",
			       current_event, last_unmapped_chan,
			       rx_ok ? "OK" : "MISS",
			       anchor.ww_current_us,
			       conn_event_rx_ok, current_event,
			       l2cap_rx_count, l2cap_tx_count);
		}

		/* 延迟打印 L2CAP RX 日志 (在事件结束后, 不影响 TIFS) */
		if (l2cap_last_rx_pending) {
			printk("[L2CAP] RX #%u: CID=0x%04X len=%u",
			       l2cap_rx_count, l2cap_last_rx_cid,
			       l2cap_last_rx_len);
			if (l2cap_last_tx_frags > 0) {
				printk(" → echo %d frags\n",
				       l2cap_last_tx_frags);
			} else {
				printk(" → TX queue full!\n");
			}
			l2cap_last_rx_pending = false;
		}
	}

	NRF_RADIO->SHORTS = 0;
	NRF_RADIO->INTENCLR = 0xFFFFFFFFUL;

	printk("\n========== Connection Summary ==========\n");
	printk("  Total events:   %u\n", conn_event_counter);
	printk("  RX OK:          %u\n", conn_event_rx_ok);
	printk("  RX timeout:     %u\n", conn_event_rx_timeout);
	printk("  RX CRC error:   %u\n", conn_event_rx_crc_err);
	printk("  L2CAP RX:       %u\n", l2cap_rx_count);
	printk("  L2CAP TX echo:  %u\n", l2cap_tx_count);
	printk("  Anchor updates: %u\n", anchor.anchor_update_count);
	printk("  Max consec miss: %u\n", anchor.max_consecutive_misses);
	printk("=========================================\n");
}
```

## src/conn.h
```c
/*
 * BLE PHY Data Channel Demo — 连接态: 连接事件、数据 PDU 收发与锚点调度
 *
 * SPDX-License-Identifier: Apache-2.0
 */

#ifndef CONN_H
#define CONN_H

#include "ble_common.h"

void conn_loop(void);

#endif /* CONN_H */
```

## src/hal_radio.h
```c
/*
 * BLE PHY Data Channel Demo — HAL 层: 硬件初始化与 Radio 配置
 *
 * SPDX-License-Identifier: Apache-2.0
 */

#ifndef HAL_RADIO_INIT_H
#define HAL_RADIO_INIT_H

#include "ble_common.h"

void hfclk_start(void);
void rtc0_start(void);
void sw_switch_timer_configure(void);
void ppi_configure(void);

void radio_ensure_disabled(void);
void radio_configure_adv(void);
void radio_configure_conn(void);

void data_chan_set(uint8_t chan);

#endif /* HAL_RADIO_INIT_H */
```

## src/l2cap.c
```c
/*
 * BLE PHY Data Channel Demo — L2CAP 基本帧: 解析、重组与回环
 *
 * BLE L2CAP Basic Frame 格式:
 *   [Length (2 bytes, LE)] [Channel ID (2 bytes, LE)] [Payload...]
 *
 * 空口传输时, 一个 L2CAP 帧可能被拆分成多个 LL Data PDU:
 *   - 第一个分片: LLID = 10 (Start), 携带 L2CAP header + 前 N 字节
 *   - 后续分片:   LLID = 01 (Continuation), 携带剩余字节
 *
 * 本模块实现:
 *   1. 接收方向: 按 LLID 重组分片为完整 L2CAP 帧
 *   2. 发送方向: 将完整 L2CAP 帧拆分为 ≤27 字节的 LL Data PDU
 *   3. 回环逻辑: 收到的数据原样发回 (echo)
 *
 * SPDX-License-Identifier: Apache-2.0
 */

#include "l2cap.h"

void l2cap_init(void)
{
	memset(&l2cap_reasm, 0, sizeof(l2cap_reasm));
	memset(&data_tx_q, 0, sizeof(data_tx_q));
}

/*===========================================================================
 * 接收: 分片重组
 *===========================================================================*/
bool l2cap_rx_fragment(uint8_t llid, const uint8_t *data, uint8_t len)
{
	if (llid == PDU_DATA_LLID_DATA_START) {
		/* 新 L2CAP 帧的第一个分片 */

		if (len < L2CAP_HDR_SIZE) {
			/* 第一个分片不够放 L2CAP header — 异常, 丢弃 */
			l2cap_reasm.in_progress = false;
			return false;
		}

		/* 提取 L2CAP Length (前 2 字节, 小端) */
		uint16_t l2cap_len = sys_get_le16(data);
		uint16_t total = l2cap_len + L2CAP_HDR_SIZE;

		if (total > sizeof(l2cap_reasm.buf)) {
			printk("[L2CAP] frame too large: %u > %u\n",
			       total, (uint16_t)sizeof(l2cap_reasm.buf));
			l2cap_reasm.in_progress = false;
			return false;
		}

		l2cap_reasm.expected_len = total;
		l2cap_reasm.received_len = 0;
		l2cap_reasm.in_progress = true;

		memcpy(l2cap_reasm.buf, data, len);
		l2cap_reasm.received_len = len;

		if (l2cap_reasm.received_len >= l2cap_reasm.expected_len) {
			l2cap_reasm.in_progress = false;
			return true;
		}
		return false;
	}

	if (llid == PDU_DATA_LLID_DATA_CONTINUE) {
		/* 后续分片 — 追加到重组缓冲区 */

		if (!l2cap_reasm.in_progress) {
			/* 没有匹配的 Start 分片 — 丢弃 */
			return false;
		}

		uint16_t remaining = l2cap_reasm.expected_len -
				     l2cap_reasm.received_len;
		uint16_t copy_len = (len < remaining) ? len : remaining;

		memcpy(l2cap_reasm.buf + l2cap_reasm.received_len,
		       data, copy_len);
		l2cap_reasm.received_len += copy_len;

		if (l2cap_reasm.received_len >= l2cap_reasm.expected_len) {
			l2cap_reasm.in_progress = false;
			return true;
		}
		return false;
	}

	return false;
}

/*===========================================================================
 * 处理完整的 L2CAP 帧
 *===========================================================================*/
void l2cap_process_complete(void)
{
	uint16_t l2cap_len = sys_get_le16(l2cap_reasm.buf);
	uint16_t cid = sys_get_le16(l2cap_reasm.buf + 2);
	uint16_t total = l2cap_len + L2CAP_HDR_SIZE;

	l2cap_rx_count++;

	/*
	 * ★ 不在此处 printk！
	 *
	 * 本函数在连接事件的 RX 处理中被调用，处于 SW TIFS 的关键路径上:
	 * RX END → 处理数据 → 准备 TX → PPI 触发 TXEN (窗口仅 ~100µs)
	 *
	 * printk 通过 UART 输出 1 行 hex dump 约需 5-10ms，远超 TIFS 窗口，
	 * 会导致 TX PPI 错过触发时机，echo 的第一个分片 (LLID=Start) 丢失。
	 *
	 * 解决方案: 保存最近一次 RX 信息，conn_loop 中在事件结束后延迟打印。
	 */
	l2cap_last_rx_cid = cid;
	l2cap_last_rx_len = l2cap_len;
	l2cap_last_rx_pending = true;

	/* 回环 (echo): 将收到的完整 L2CAP 帧原样发回 */
	int queued = l2cap_tx_enqueue(l2cap_reasm.buf, total);

	if (queued > 0) {
		l2cap_tx_count++;
		l2cap_last_tx_frags = queued;
	} else {
		l2cap_last_tx_frags = 0;
	}
}

/*===========================================================================
 * 发送: L2CAP 帧分片入队
 *
 * 将一个完整的 L2CAP 帧拆分为 ≤ LL_DATA_MTU_DEFAULT 字节的 PDU 分片,
 * 放入 TX 队列。conn_event 每次取一个分片发送。
 *===========================================================================*/
int l2cap_tx_enqueue(const uint8_t *buf, uint16_t total_len)
{
	uint16_t offset = 0;
	int frag_count = 0;
	bool first = true;

	while (offset < total_len) {
		if (data_tx_q.count >= TX_QUEUE_SIZE) {
			return 0;  /* 队列满 */
		}

		struct tx_frag *f = &data_tx_q.frags[data_tx_q.tail];
		uint16_t chunk = total_len - offset;

		if (chunk > LL_DATA_MTU_DEFAULT) {
			chunk = LL_DATA_MTU_DEFAULT;
		}

		memcpy(f->data, buf + offset, chunk);
		f->len = (uint8_t)chunk;
		f->llid = first ? PDU_DATA_LLID_DATA_START
			        : PDU_DATA_LLID_DATA_CONTINUE;

		data_tx_q.tail = (data_tx_q.tail + 1) % TX_QUEUE_SIZE;
		data_tx_q.count++;

		offset += chunk;
		frag_count++;
		first = false;
	}

	return frag_count;
}

/*===========================================================================
 * 发送: 从 TX 队列取出一个分片
 *===========================================================================*/
bool l2cap_tx_dequeue(struct pdu_data *pdu)
{
	if (data_tx_q.count == 0) {
		return false;
	}

	struct tx_frag *f = &data_tx_q.frags[data_tx_q.head];

	memset(pdu, 0, sizeof(*pdu));
	pdu->ll_id = f->llid;
	pdu->nesn  = rx_nesn;
	pdu->sn    = tx_sn;
	pdu->md    = (data_tx_q.count > 1) ? 1 : 0;
	pdu->len   = f->len;

	memcpy(pdu->lldata, f->data, f->len);

	data_tx_q.head = (data_tx_q.head + 1) % TX_QUEUE_SIZE;
	data_tx_q.count--;

	return true;
}
```

## src/ll_pdu.h
```c
/*
 * BLE PHY Data Channel Demo — 链路层: PDU 构造、LL Control、信道选择
 *
 * SPDX-License-Identifier: Apache-2.0
 */

#ifndef LL_PDU_H
#define LL_PDU_H

#include "ble_common.h"

uint8_t count_ones(const uint8_t *data, uint8_t len);

/* ADV PDU */
void build_adv_ind_pdu(void);

/* Data PDU */
void build_empty_pdu(struct pdu_data *pdu);
void build_version_ind(struct pdu_data *pdu);
void build_feature_rsp(struct pdu_data *pdu);
void build_unknown_rsp(struct pdu_data *pdu, uint8_t unknown_type);
void build_length_rsp(struct pdu_data *pdu);

/* LL Control */
bool handle_ll_control(const struct pdu_data *rx_pdu);

/* CONNECT_IND */
bool validate_connect_ind(const struct pdu_adv *rx_pdu);
void parse_connect_ind(const struct pdu_adv *rx_pdu);
void print_connect_ind(void);

/* Channel Selection Algorithm #1 */
uint8_t chan_sel_1(void);

#endif /* LL_PDU_H */
```
