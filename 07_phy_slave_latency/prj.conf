## CMakeLists.txt
```
# SPDX-License-Identifier: Apache-2.0

cmake_minimum_required(VERSION 3.20.0)
find_package(Zephyr REQUIRED HINTS $ENV{ZEPHYR_BASE})
project(ble_phy_slave_latency)

target_sources(app PRIVATE
  src/main.c
  ../stack/hal_radio.c
  ../stack/adv.c
  ../stack/conn.c
  ../stack/conn_event.c
  ../stack/anchor.c
  ../stack/slave_latency.c
  ../stack/ll_pdu.c
  ../stack/compat_globals.c
)

target_compile_definitions(app PRIVATE
  BLE_FEATURE_MULTI_PDU=0
  BLE_FEATURE_ATT=0
  BLE_FEATURE_SMP=0
  BLE_FEATURE_SLAVE_CPR=0
  BLE_FEATURE_SLAVE_TERMINATE=0
  BLE_FEATURE_GATT_NOTIFY=0
  BLE_FEATURE_LL_PROCEDURE=0
)

target_include_directories(app PRIVATE
  ${CMAKE_CURRENT_SOURCE_DIR}/src
  ${CMAKE_CURRENT_SOURCE_DIR}/../stack
  ${ZEPHYR_BASE}/subsys/bluetooth/controller
  ${ZEPHYR_BASE}/subsys/bluetooth/controller/include
  ${ZEPHYR_BASE}/subsys/bluetooth/controller/ll_sw/nordic
  ${ZEPHYR_BASE}/subsys/bluetooth/controller/ll_sw
  ${ZEPHYR_BASE}/subsys/bluetooth/controller/ll_sw/nordic/lll
  ${ZEPHYR_BASE}/subsys/bluetooth/controller/ll_sw/nordic/hal/nrf5/nrfx_glue
  ${ZEPHYR_BASE}/subsys/bluetooth
)
```

## prj.conf
```kconfig
# BLE PHY Slave Latency Demo
# 演示从机延迟 (Slave Latency) 机制

CONFIG_GPIO=y
CONFIG_SERIAL=y
CONFIG_CONSOLE=y
CONFIG_UART_CONSOLE=y
CONFIG_PRINTK=y

CONFIG_BT=y
CONFIG_BT_LL_SW_SPLIT=y
CONFIG_BT_BROADCASTER=y
CONFIG_BT_PERIPHERAL=y

CONFIG_BT_OBSERVER=n
CONFIG_BT_CENTRAL=n
```

## src/main.c
```c
/*
 * BLE PHY Slave Latency Demo
 *
 * This demo adds Slave Latency on top of 06_phy_data_channel:
 *
 * ┌─────────────────────────────────────────────────────────────────┐
 * │  What is Slave Latency?                                         │
 * │                                                                 │
 * │  In a normal connection, the Slave must wake the radio every    │
 * │  connInterval. When connSlaveLatency > 0 in CONNECT_IND:        │
 * │    the Slave may skip up to connSlaveLatency connection events  │
 * │    without listening, greatly reducing radio power.             │
 * │                                                                 │
 * │  Constraints:                                                   │
 * │    1. Pending TX data -> the Slave must listen                  │
 * │    2. Once the latency limit is reached, it must listen         │
 * │    3. WW grows proportionally while events are skipped          │
 * │    4. Channel selection must still advance on skipped events    │
 * └─────────────────────────────────────────────────────────────────┘
 *
 * Timeline illustration (latency=3):
 *
 *   Event:  #0    #1    #2    #3    #4    #5    #6    #7
 *   Action: LISTEN skip  skip  skip  LISTEN skip  skip  skip
 *   WW:     0     +1p   +2p   +3p   0     +1p   +2p   +3p
 *
 *   (p = ww_periodic_us, WW resets after a successful LISTEN)
 *
 * SPDX-License-Identifier: Apache-2.0
 */

#include "ble_common.h"
#include "hal_radio.h"
#include "ll_pdu.h"
#include "adv.h"
#include "conn.h"

/*===========================================================================
 * Global definitions
 *===========================================================================*/

const uint8_t adv_addr[BDADDR_SIZE] = {
	0x11, 0x22, 0x33, 0x44, 0x55, 0x66
};

uint8_t adv_data[] = {
	0x02, 0x01, 0x06,
	0x06, 0x09, 'S', 'L', 'a', 't', 'e'
};
uint8_t adv_data_len = sizeof(adv_data);

int main(void)
{
	printk("\n");
	printk("===================================================\n");
	printk("  BLE PHY Slave Latency Demo\n");
	printk("  演示从机延迟 (Slave Latency) 省电机制\n");
	printk("===================================================\n");
	printk("Device: %s  Addr: %02X:%02X:%02X:%02X:%02X:%02X\n",
	       ADV_NAME,
	       adv_addr[5], adv_addr[4], adv_addr[3],
	       adv_addr[2], adv_addr[1], adv_addr[0]);
	printk("\n");

	hfclk_start();
	rtc0_start();
	sw_switch_timer_configure();
	ppi_configure();

	while (1) {
		printk("[STATE] Entering ADVERTISING state\n");
		adv_event_count = 0;

		radio_configure_adv();
		build_adv_ind_pdu();

		bool connected = false;
		while (!connected) {
			int ret = adv_event();
			if (ret == 1) {
				connected = true;
			} else {
				k_msleep(ADV_INTERVAL_MS);
			}
		}

		conn_loop();

		printk("[STATE] Connection lost, returning to advertising...\n\n");
		radio_ensure_disabled();
		k_msleep(100);
	}

	return 0;
}
```
